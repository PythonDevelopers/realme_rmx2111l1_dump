/dts-v1/;

/ {

	__fixups__ {
		accdet = "/fragment@69:target:0";
		adc = "/fragment@10/__overlay__/chg:io-channels:0\0/fragment@10/__overlay__/chg:io-channels:8\0/fragment@10/__overlay__/chg:io-channels:16\0/fragment@10/__overlay__/chg:io-channels:24\0/fragment@10/__overlay__/chg:io-channels:32\0/fragment@10/__overlay__/chg:io-channels:40\0/fragment@10/__overlay__/chg:io-channels:48\0/fragment@10/__overlay__/chg:io-channels:56";
		apuart0 = "/fragment@15:target:0";
		auxadc = "/fragment@12/__overlay__:io-channels:0\0/fragment@12/__overlay__:io-channels:8\0/fragment@12/__overlay__:io-channels:16\0/fragment@38:target:0\0/fragment@39/__overlay__:io-channels:0";
		bat_gm30 = "/fragment@17:target:0";
		charger = "/fragment@12:target:0";
		chosen = "/fragment@1:target:0";
		consys = "/fragment@25:target:0";
		dispsys_config = "/fragment@66:target:0";
		dsi0 = "/fragment@67:target:0";
		dsi_te = "/fragment@58:target:0";
		fpc_interrupt = "/fragment@74:target:0";
		goodix_fp = "/fragment@76:target:0";
		gpio = "/fragment@52:target:0";
		gpio_usage_mapping = "/fragment@51:target:0";
		i2c0 = "/fragment@41:target:0";
		i2c1 = "/fragment@42:target:0";
		i2c2 = "/fragment@33:target:0\0/fragment@36:target:0\0/fragment@37:target:0\0/fragment@43:target:0";
		i2c3 = "/fragment@22:target:0\0/fragment@44:target:0";
		i2c4 = "/fragment@34:target:0\0/fragment@45:target:0";
		i2c5 = "/fragment@46:target:0";
		i2c6 = "/fragment@5:target:0\0/fragment@29:target:0\0/fragment@47:target:0";
		i2c7 = "/fragment@18:target:0\0/fragment@20:target:0\0/fragment@48:target:0";
		i2c8 = "/fragment@35:target:0\0/fragment@49:target:0";
		i2c9 = "/fragment@50:target:0";
		irq_nfc = "/fragment@54:target:0";
		irtx_pwm = "/fragment@70:target:0";
		kd_camera_hw1 = "/fragment@32:target:0\0/fragment@62:target:0";
		keypad = "/fragment@3:target:0\0/fragment@64:target:0";
		md1_sim1_hot_plug_eint = "/fragment@59:target:0";
		md_auxadc = "/fragment@39:target:0";
		mrdump_ext_rst = "/fragment@53:target:0";
		mt6360_ldo = "/fragment@11:target:0";
		mt6360_pmic = "/fragment@8:target:0";
		mt6360_pmu = "/fragment@7:target:0\0/fragment@10:target:0\0/fragment@10/__overlay__/chg:interrupt-parent:0";
		mt6360_typec = "/fragment@9:target:0";
		mt_pmic_vcamio_ldo_reg = "/fragment@32/__overlay__:cam0_vcamio-supply:0\0/fragment@32/__overlay__:cam1_vcamio-supply:0\0/fragment@32/__overlay__:cam2_vcamio-supply:0\0/fragment@32/__overlay__:cam3_vcamio-supply:0\0/fragment@32/__overlay__:cam4_vcamio-supply:0\0/fragment@60:target:0\0/fragment@62/__overlay__:vcamio-supply:0";
		mt_pmic_vcn13_ldo_reg = "/fragment@32/__overlay__:cam2_vcamd-supply:0";
		mt_pmic_vfp_ldo_reg = "/fragment@77/__overlay__/fingerprint@0:dvdd-supply:0";
		mt_pmic_vio28_ldo_reg = "/fragment@13:target:0";
		mt_pmic_vmc_ldo_reg = "/fragment@67/__overlay__/panel4@0:ldo3-supply:0";
		mt_pmic_vmch_ldo_reg = "/fragment@67/__overlay__/panel4@0:ldo5-supply:0";
		mt_pmic_vtp_ldo_reg = "/fragment@32/__overlay__:vcammainaf-supply:0\0/fragment@61:target:0\0/fragment@63/__overlay__:vtouch-supply:0";
		mtkfb = "/fragment@68:target:0";
		odm = "/fragment@2:target:0\0/fragment@79:target:0";
		oppo_fp_common = "/fragment@72:target:0";
		pio = "/fragment@2/__overlay__/kpd_volume_up:interrupt-parent:0\0/fragment@2/__overlay__/kpd_volume_down:interrupt-parent:0\0/fragment@2/__overlay__/oppo_devinfo:Hw,sim_det:0\0/fragment@3/__overlay__:keypad,volume-up:0\0/fragment@3/__overlay__:keypad,volume-down:0\0/fragment@4:target:0\0/fragment@5/__overlay__/aw87339@58:reset-gpio:0\0/fragment@7/__overlay__:mt6360,intr_gpio:0\0/fragment@9/__overlay__:mt6360pd,intr_gpio:0\0/fragment@12/__overlay__:qcom,chargerid_switch-gpio:0\0/fragment@12/__overlay__:qcom,ship-gpio:0\0/fragment@12/__overlay__:qcom,dischg-gpio:0\0/fragment@14:target:0\0/fragment@16:target:0\0/fragment@19:target:0\0/fragment@20/__overlay__/rk826_fastcg@0a:qcom,charging_switch1-gpio:0\0/fragment@20/__overlay__/rk826_fastcg@0a:qcom,charging_switch1_ctr1-gpio:0\0/fragment@20/__overlay__/rk826_fastcg@0a:qcom,charging_reset-gpio:0\0/fragment@20/__overlay__/rk826_fastcg@0a:qcom,charging_clock-gpio:0\0/fragment@20/__overlay__/rk826_fastcg@0a:qcom,charging_data-gpio:0\0/fragment@20/__overlay__/rk826_fastcg@0a:qcom,vooc_asic_id-gpio:0\0/fragment@21:target:0\0/fragment@22/__overlay__/nfc_st21@8:gpio-irq-std:0\0/fragment@22/__overlay__/nfc_st21@8:gpio-rst-std:0\0/fragment@22/__overlay__/nfc_st21@8:gpio-clkreq-std:0\0/fragment@23/__overlay__/st54spi@0:gpio-power-std:0\0/fragment@24:target:0\0/fragment@26/__overlay__/touchscreen@0:interrupt-parent:0\0/fragment@26/__overlay__/touchscreen@0:irq-gpio:0\0/fragment@26/__overlay__/touchscreen@0:reset-gpio:0\0/fragment@27:target:0\0/fragment@31:target:0\0/fragment@51/__overlay__:GPIO_SIM1_HOT_PLUG:0\0/fragment@51/__overlay__:GPIO_SIM2_SCLK:0\0/fragment@51/__overlay__:GPIO_SIM2_SRST:0\0/fragment@51/__overlay__:GPIO_SIM2_SIO:0\0/fragment@51/__overlay__:GPIO_SIM1_SIO:0\0/fragment@51/__overlay__:GPIO_SIM1_SRST:0\0/fragment@51/__overlay__:GPIO_SIM1_SCLK:0\0/fragment@51/__overlay__:GPIO_FDD_BAND_SUPPORT_DETECT_1ST_PIN:0\0/fragment@51/__overlay__:GPIO_FDD_BAND_SUPPORT_DETECT_2ND_PIN:0\0/fragment@51/__overlay__:GPIO_FDD_BAND_SUPPORT_DETECT_3RD_PIN:0\0/fragment@51/__overlay__:GPIO_FDD_BAND_SUPPORT_DETECT_4TH_PIN:0\0/fragment@51/__overlay__:GPIO_RF_PWREN_RST_PIN:0\0/fragment@53/__overlay__:interrupt-parent:0\0/fragment@53/__overlay__:deb-gpios:0\0/fragment@54/__overlay__:interrupt-parent:0\0/fragment@55/__overlay__:interrupt-parent:0\0/fragment@56/__overlay__:interrupt-parent:0\0/fragment@57/__overlay__:interrupt-parent:0\0/fragment@57/__overlay__:deb-gpios:0\0/fragment@58/__overlay__:interrupt-parent:0\0/fragment@65:target:0\0/fragment@67/__overlay__/panel1@0:pm-enable-gpios:0\0/fragment@67/__overlay__/panel1@0:reset-gpios:0\0/fragment@67/__overlay__/panel1@0:bias-gpios:0\0/fragment@67/__overlay__/panel1@0:bias-gpios:12\0/fragment@67/__overlay__/panel2@0:lcd-1p8-gpios:0\0/fragment@67/__overlay__/panel2@0:pm-enable-gpios:0\0/fragment@67/__overlay__/panel2@0:reset-gpios:0\0/fragment@67/__overlay__/panel2@0:bias-gpios:0\0/fragment@67/__overlay__/panel2@0:bias-gpios:12\0/fragment@67/__overlay__/panel3@0:lcd-1p8-gpios:0\0/fragment@67/__overlay__/panel3@0:pm-enable-gpios:0\0/fragment@67/__overlay__/panel3@0:reset-gpios:0\0/fragment@67/__overlay__/panel3@0:bias-gpios:0\0/fragment@67/__overlay__/panel3@0:bias-gpios:12\0/fragment@67/__overlay__/panel4@0:pm-enable-gpios:0\0/fragment@67/__overlay__/panel4@0:reset-gpios:0\0/fragment@71:target:0\0/fragment@72/__overlay__:oppo,fp_gpio_id:0\0/fragment@73:target:0\0/fragment@74/__overlay__:fpc,irq-gpio:0\0/fragment@74/__overlay__:fpc,reset-gpio:0\0/fragment@74/__overlay__:fpc,vdd-en:0\0/fragment@74/__overlay__:fpc,gpio_cs:0\0/fragment@74/__overlay__:pw_en_gpio:0\0/fragment@75:target:0\0/fragment@76/__overlay__:goodix,gpio_irq:0\0/fragment@76/__overlay__:goodix,gpio_reset:0\0/fragment@76/__overlay__:goodix,gpio_cs:0\0/fragment@78:target:0";
		pmic_clock_buffer_ctrl = "/fragment@40:target:0";
		reserved_memory = "/fragment@0:target:0";
		snd_audio_dsp = "/fragment@6:target:0";
		sound = "/fragment@28:target:0";
		spi1 = "/fragment@23:target:0";
		spi4 = "/fragment@26:target:0";
		spi5 = "/fragment@77:target:0";
		subpmic_pmu_eint = "/fragment@56:target:0";
		swtp = "/fragment@30:target:0\0/fragment@57:target:0";
		tcpc_pd = "/fragment@55:target:0";
		touch = "/fragment@63:target:0";
	};

	__local_fixups__ {

		fragment@12 {

			__overlay__ {
				pinctrl-0 = <0x00>;
				pinctrl-1 = <0x00>;
				pinctrl-2 = <0x00>;
				pinctrl-3 = <0x00>;
				pinctrl-4 = <0x00>;
				pinctrl-5 = <0x00>;
				pinctrl-6 = <0x00>;
			};
		};

		fragment@15 {

			__overlay__ {
				pinctrl-0 = <0x00>;
				pinctrl-1 = <0x00>;
			};
		};

		fragment@18 {

			__overlay__ {
				pinctrl-0 = <0x00>;
				pinctrl-1 = <0x00>;
			};
		};

		fragment@20 {

			__overlay__ {

				rk826_fastcg@0a {
					pinctrl-0 = <0x00>;
					pinctrl-1 = <0x00>;
					pinctrl-10 = <0x00>;
					pinctrl-11 = <0x00>;
					pinctrl-12 = <0x00>;
					pinctrl-13 = <0x00>;
					pinctrl-14 = <0x00>;
					pinctrl-15 = <0x00>;
					pinctrl-2 = <0x00>;
					pinctrl-3 = <0x00>;
					pinctrl-4 = <0x00>;
					pinctrl-5 = <0x00>;
					pinctrl-6 = <0x00>;
					pinctrl-7 = <0x00>;
					pinctrl-8 = <0x00>;
					pinctrl-9 = <0x00>;
				};
			};
		};

		fragment@25 {

			__overlay__ {
				pinctrl-0 = <0x00>;
				pinctrl-1 = <0x00>;
				pinctrl-2 = <0x00>;
				pinctrl-3 = <0x00>;
			};
		};

		fragment@26 {

			__overlay__ {

				touchscreen@0 {
					pinctrl-0 = <0x00 0x04 0x08>;
					pinctrl-1 = <0x00 0x04>;
				};
			};
		};

		fragment@28 {

			__overlay__ {

				mediatek,speaker-codec {
					sound-dai = <0x00>;
				};
			};
		};

		fragment@3 {

			__overlay__ {
				pinctrl-0 = <0x00>;
				pinctrl-1 = <0x00>;
			};
		};

		fragment@32 {

			__overlay__ {
				pinctrl-0 = <0x00>;
				pinctrl-1 = <0x00>;
				pinctrl-10 = <0x00>;
				pinctrl-11 = <0x00>;
				pinctrl-12 = <0x00>;
				pinctrl-13 = <0x00>;
				pinctrl-14 = <0x00>;
				pinctrl-15 = <0x00>;
				pinctrl-16 = <0x00>;
				pinctrl-17 = <0x00>;
				pinctrl-18 = <0x00>;
				pinctrl-19 = <0x00>;
				pinctrl-2 = <0x00>;
				pinctrl-20 = <0x00>;
				pinctrl-21 = <0x00>;
				pinctrl-22 = <0x00>;
				pinctrl-23 = <0x00>;
				pinctrl-24 = <0x00>;
				pinctrl-25 = <0x00>;
				pinctrl-26 = <0x00>;
				pinctrl-27 = <0x00>;
				pinctrl-28 = <0x00>;
				pinctrl-29 = <0x00>;
				pinctrl-3 = <0x00>;
				pinctrl-30 = <0x00>;
				pinctrl-31 = <0x00>;
				pinctrl-32 = <0x00>;
				pinctrl-33 = <0x00>;
				pinctrl-34 = <0x00>;
				pinctrl-35 = <0x00>;
				pinctrl-36 = <0x00>;
				pinctrl-37 = <0x00>;
				pinctrl-38 = <0x00>;
				pinctrl-39 = <0x00>;
				pinctrl-4 = <0x00>;
				pinctrl-40 = <0x00>;
				pinctrl-41 = <0x00>;
				pinctrl-42 = <0x00>;
				pinctrl-43 = <0x00>;
				pinctrl-44 = <0x00>;
				pinctrl-45 = <0x00>;
				pinctrl-46 = <0x00>;
				pinctrl-47 = <0x00>;
				pinctrl-48 = <0x00>;
				pinctrl-49 = <0x00>;
				pinctrl-5 = <0x00>;
				pinctrl-50 = <0x00>;
				pinctrl-51 = <0x00>;
				pinctrl-52 = <0x00>;
				pinctrl-53 = <0x00>;
				pinctrl-6 = <0x00>;
				pinctrl-7 = <0x00>;
				pinctrl-8 = <0x00>;
				pinctrl-9 = <0x00>;
			};
		};

		fragment@66 {

			__overlay__ {
				pinctrl-0 = <0x00>;
				pinctrl-1 = <0x00>;
				pinctrl-2 = <0x00>;
			};
		};

		fragment@67 {

			__overlay__ {

				panel1@0 {

					port {

						endpoint {
							remote-endpoint = <0x00>;
						};
					};
				};

				panel2@0 {

					port {

						endpoint {
							remote-endpoint = <0x00>;
						};
					};
				};

				panel3@0 {

					port {

						endpoint {
							remote-endpoint = <0x00>;
						};
					};
				};

				panel4@0 {

					port {

						endpoint {
							remote-endpoint = <0x00>;
						};
					};
				};

				ports {

					port {

						endpoint {
							remote-endpoint = <0x00>;
						};
					};
				};
			};
		};

		fragment@68 {

			__overlay__ {
				pinctrl-0 = <0x00>;
				pinctrl-1 = <0x00>;
				pinctrl-2 = <0x00>;
				pinctrl-3 = <0x00>;
				pinctrl-4 = <0x00>;
				pinctrl-5 = <0x00>;
				pinctrl-6 = <0x00>;
			};
		};

		fragment@70 {

			__overlay__ {
				pinctrl-0 = <0x00>;
				pinctrl-1 = <0x00>;
			};
		};

		fragment@72 {

			__overlay__ {
				pinctrl-0 = <0x00>;
			};
		};

		fragment@74 {

			__overlay__ {
				pinctrl-0 = <0x00 0x04 0x08>;
				pinctrl-1 = <0x00>;
			};
		};

		fragment@76 {

			__overlay__ {
				pinctrl-0 = <0x00 0x04>;
				pinctrl-1 = <0x00 0x04 0x08 0x0c>;
				pinctrl-2 = <0x00>;
			};
		};
	};

	__symbols__ {
		camera_main_af_mtk = "/fragment@43/__overlay__/camera_main_af@18";
		camera_main_mtk = "/fragment@43/__overlay__/camera_main@1a";
		camera_main_three_mtk = "/fragment@43/__overlay__/camera_main_three@1b";
		camera_main_two_mtk = "/fragment@49/__overlay__/camera_main_two@10";
		camera_mipi_switch1_high = "/fragment@31/__overlay__/camera_mipi_switch1_output_high@gpio38";
		camera_mipi_switch1_low = "/fragment@31/__overlay__/camera_mipi_switch1_output_low@gpio38";
		camera_pins_cam0_mclk_2ma = "/fragment@31/__overlay__/camera_pins_cam0_mclk_2ma";
		camera_pins_cam0_mclk_4ma = "/fragment@31/__overlay__/camera_pins_cam0_mclk_4ma";
		camera_pins_cam0_mclk_6ma = "/fragment@31/__overlay__/camera_pins_cam0_mclk_6ma";
		camera_pins_cam0_mclk_8ma = "/fragment@31/__overlay__/camera_pins_cam0_mclk_8ma";
		camera_pins_cam0_mclk_off = "/fragment@31/__overlay__/camera_pins_cam0_mclk_off";
		camera_pins_cam0_rst_0 = "/fragment@31/__overlay__/cam0@0";
		camera_pins_cam0_rst_1 = "/fragment@31/__overlay__/cam0@1";
		camera_pins_cam0_vcama_0 = "/fragment@31/__overlay__/cam0@vcam2";
		camera_pins_cam0_vcama_1 = "/fragment@31/__overlay__/cam0@vcam3";
		camera_pins_cam0_vcamd_0 = "/fragment@31/__overlay__/cam0@vcam0";
		camera_pins_cam0_vcamd_1 = "/fragment@31/__overlay__/cam0@vcam1";
		camera_pins_cam1_mclk_2ma = "/fragment@31/__overlay__/camera_pins_cam1_mclk_2ma";
		camera_pins_cam1_mclk_4ma = "/fragment@31/__overlay__/camera_pins_cam1_mclk_4ma";
		camera_pins_cam1_mclk_6ma = "/fragment@31/__overlay__/camera_pins_cam1_mclk_6ma";
		camera_pins_cam1_mclk_8ma = "/fragment@31/__overlay__/camera_pins_cam1_mclk_8ma";
		camera_pins_cam1_mclk_off = "/fragment@31/__overlay__/camera_pins_cam1_mclk_off";
		camera_pins_cam1_rst_0 = "/fragment@31/__overlay__/cam1@0";
		camera_pins_cam1_rst_1 = "/fragment@31/__overlay__/cam1@1";
		camera_pins_cam1_vcama_0 = "/fragment@31/__overlay__/cam1@vcam2";
		camera_pins_cam1_vcama_1 = "/fragment@31/__overlay__/cam1@vcam3";
		camera_pins_cam1_vcamd_0 = "/fragment@31/__overlay__/cam1@vcam0";
		camera_pins_cam1_vcamd_1 = "/fragment@31/__overlay__/cam1@vcam1";
		camera_pins_cam2_mclk_2ma = "/fragment@31/__overlay__/camera_pins_cam2_mclk_2ma";
		camera_pins_cam2_mclk_4ma = "/fragment@31/__overlay__/camera_pins_cam2_mclk_4ma";
		camera_pins_cam2_mclk_6ma = "/fragment@31/__overlay__/camera_pins_cam2_mclk_6ma";
		camera_pins_cam2_mclk_8ma = "/fragment@31/__overlay__/camera_pins_cam2_mclk_8ma";
		camera_pins_cam2_mclk_off = "/fragment@31/__overlay__/camera_pins_cam2_mclk_off";
		camera_pins_cam2_rst_0 = "/fragment@31/__overlay__/cam2@0";
		camera_pins_cam2_rst_1 = "/fragment@31/__overlay__/cam2@1";
		camera_pins_cam2_vcama_0 = "/fragment@31/__overlay__/cam2@vcam2";
		camera_pins_cam2_vcama_1 = "/fragment@31/__overlay__/cam2@vcam3";
		camera_pins_cam3_mclk_2ma = "/fragment@31/__overlay__/camera_pins_cam3_mclk_2ma";
		camera_pins_cam3_mclk_4ma = "/fragment@31/__overlay__/camera_pins_cam3_mclk_4ma";
		camera_pins_cam3_mclk_6ma = "/fragment@31/__overlay__/camera_pins_cam3_mclk_6ma";
		camera_pins_cam3_mclk_8ma = "/fragment@31/__overlay__/camera_pins_cam3_mclk_8ma";
		camera_pins_cam3_mclk_off = "/fragment@31/__overlay__/camera_pins_cam3_mclk_off";
		camera_pins_cam3_rst_0 = "/fragment@31/__overlay__/cam3@0";
		camera_pins_cam3_rst_1 = "/fragment@31/__overlay__/cam3@1";
		camera_pins_cam3_vcama_0 = "/fragment@31/__overlay__/cam3@vcam2";
		camera_pins_cam3_vcama_1 = "/fragment@31/__overlay__/cam3@vcam3";
		camera_pins_cam4_mclk_2ma = "/fragment@31/__overlay__/camera_pins_cam4_mclk_2ma";
		camera_pins_cam4_mclk_4ma = "/fragment@31/__overlay__/camera_pins_cam4_mclk_4ma";
		camera_pins_cam4_mclk_6ma = "/fragment@31/__overlay__/camera_pins_cam4_mclk_6ma";
		camera_pins_cam4_mclk_8ma = "/fragment@31/__overlay__/camera_pins_cam4_mclk_8ma";
		camera_pins_cam4_mclk_off = "/fragment@31/__overlay__/camera_pins_cam4_mclk_off";
		camera_pins_cam4_rst_0 = "/fragment@31/__overlay__/cam4@0";
		camera_pins_cam4_rst_1 = "/fragment@31/__overlay__/cam4@1";
		camera_pins_cam4_vcama_0 = "/fragment@31/__overlay__/cam4@vcam2";
		camera_pins_cam4_vcama_1 = "/fragment@31/__overlay__/cam4@vcam3";
		camera_pins_default = "/fragment@31/__overlay__/camdefault";
		camera_sub_mtk = "/fragment@45/__overlay__/camera_sub@1a";
		camera_sub_two_mtk = "/fragment@45/__overlay__/camera_sub_two@1c";
		camera_vcamd_sel_high = "/fragment@31/__overlay__/camera_dvdd_switch_output_high@gpio88";
		camera_vcamd_sel_low = "/fragment@31/__overlay__/camera_dvdd_switch_output_low@gpio88";
		charger_pins_default = "/fragment@14/__overlay__/eint0default";
		charger_pins_eint_output0 = "/fragment@14/__overlay__/charger_gpio_as_output_low";
		charger_pins_eint_output1 = "/fragment@14/__overlay__/charger_gpio_as_output_high";
		charging_clock_active = "/fragment@21/__overlay__/charging_clock_active";
		charging_clock_sleep = "/fragment@21/__overlay__/charging_clock_sleep";
		charging_data_active = "/fragment@21/__overlay__/charging_data_active";
		charging_data_sleep = "/fragment@21/__overlay__/charging_data_sleep";
		charging_reset_active = "/fragment@21/__overlay__/charging_reset_active";
		charging_reset_sleep = "/fragment@21/__overlay__/charging_reset_sleep";
		charging_switch1_active = "/fragment@21/__overlay__/charging_switch1_active";
		charging_switch1_ctr1_active = "/fragment@21/__overlay__/charging_switch1_ctr1_active";
		charging_switch1_ctr1_sleep = "/fragment@21/__overlay__/charging_switch1_ctr1_sleep";
		charging_switch1_sleep = "/fragment@21/__overlay__/charging_switch1_sleep";
		consys_pins_default = "/fragment@24/__overlay__/consys_default";
		ctp_gt9896s_int_active = "/fragment@27/__overlay__/int1_active";
		ctp_gt9896s_int_suspend = "/fragment@27/__overlay__/int1_suspend";
		ctp_gt9896s_pins_default = "/fragment@27/__overlay__/pins_default";
		ctp_gt9896s_reset_active = "/fragment@27/__overlay__/reset1_active";
		ctp_gt9896s_reset_suspend = "/fragment@27/__overlay__/reset1_suspend";
		ctp_gt9896s_spi_mode = "/fragment@27/__overlay__/spimode_default";
		ctp_pins_default = "/fragment@27/__overlay__/eintdefault";
		ctp_ts_i2c_mode = "/fragment@27/__overlay__/i2cmode_default";
		ctp_ts_int_active = "/fragment@27/__overlay__/int_active";
		ctp_ts_int_suspend = "/fragment@27/__overlay__/int_suspend";
		ctp_ts_reset_active = "/fragment@27/__overlay__/reset_active";
		ctp_ts_reset_suspend = "/fragment@27/__overlay__/reset_suspend";
		dischg_disable = "/fragment@14/__overlay__/dischg_disable";
		dischg_enable = "/fragment@14/__overlay__/dischg_enable";
		dsi_out = "/fragment@67/__overlay__/ports/port/endpoint";
		fpc_irq_default = "/fragment@75/__overlay__/fpc_irq_default";
		fpc_pwr_default = "/fragment@75/__overlay__/fpc_pwr_default";
		fpc_reset_default = "/fragment@75/__overlay__/fpc_reset_default";
		gpio_fpc_cs_func = "/fragment@75/__overlay__/gpio_fpc_cs_func";
		gpio_goodix_clk_6mA = "/fragment@78/__overlay__/gpio_goodix_clk_6mA";
		gpio_goodix_cs_6mA = "/fragment@78/__overlay__/gpio_goodix_cs_6mA";
		gpio_goodix_cs_func = "/fragment@78/__overlay__/gpio_goodix_cs_func";
		gpio_goodix_irq_default = "/fragment@78/__overlay__/gpio_goodix_irq_default";
		gpio_goodix_miso_6mA = "/fragment@78/__overlay__/gpio_goodix_miso_6mA";
		gpio_goodix_mosi_6mA = "/fragment@78/__overlay__/gpio_goodix_mosi_6mA";
		gpio_goodix_reset_default = "/fragment@78/__overlay__/gpio_goodix_reset_default";
		gpio_id0_default = "/fragment@73/__overlay__/gpio_id0_default";
		gpslna_pins_init = "/fragment@24/__overlay__/gpslna@0";
		gpslna_pins_oh = "/fragment@24/__overlay__/gpslna@1";
		gpslna_pins_ol = "/fragment@24/__overlay__/gpslna@2";
		i2c7_i2c_state = "/fragment@19/__overlay__/i2c7_sda_i2c_state";
		i2c7_output_low_state = "/fragment@19/__overlay__/i2c7_sda_output_low_state";
		i2c_lcd_bias_mtk = "/fragment@47/__overlay__/i2c_lcd_bias@3e";
		irtx_gpio_led_default = "/fragment@71/__overlay__/irtx_gpio_led_def@gpio57";
		irtx_gpio_led_set = "/fragment@71/__overlay__/irtx_gpio_led_set@gpio57";
		kpd_volume_down = "/fragment@2/__overlay__/kpd_volume_down";
		kpd_volume_up = "/fragment@2/__overlay__/kpd_volume_up";
		led0 = "/fragment@2/__overlay__/led@0";
		led1 = "/fragment@2/__overlay__/led@1";
		led2 = "/fragment@2/__overlay__/led@2";
		led3 = "/fragment@2/__overlay__/led@3";
		led4 = "/fragment@2/__overlay__/led@4";
		led5 = "/fragment@2/__overlay__/led@5";
		led6 = "/fragment@2/__overlay__/led@6";
		mtk_camera_eeprom0 = "/fragment@33/__overlay__/camera_eeprom0@50";
		mtk_camera_eeprom1 = "/fragment@34/__overlay__/camera_eeprom1@51";
		mtk_camera_eeprom2 = "/fragment@35/__overlay__/camera_eeprom2@50";
		mtk_camera_eeprom3 = "/fragment@36/__overlay__/camera_eeprom3@52";
		mtk_camera_eeprom4 = "/fragment@37/__overlay__/camera_eeprom4@54";
		mtkfb_pins_lcd_bias_enn0 = "/fragment@65/__overlay__/lcd_bias_enn0_gpio";
		mtkfb_pins_lcd_bias_enn1 = "/fragment@65/__overlay__/lcd_bias_enn1_gpio";
		mtkfb_pins_lcd_bias_enp0 = "/fragment@65/__overlay__/lcd_bias_enp0_gpio";
		mtkfb_pins_lcd_bias_enp1 = "/fragment@65/__overlay__/lcd_bias_enp1_gpio";
		mtkfb_pins_lcm_dsi_te = "/fragment@65/__overlay__/lcm_dsi_te";
		mtkfb_pins_lcm_rst_out0_gpio = "/fragment@65/__overlay__/lcm_rst_out0_gpio";
		mtkfb_pins_lcm_rst_out1_gpio = "/fragment@65/__overlay__/lcm_rst_out1_gpio";
		nfc_mtk = "/fragment@44/__overlay__/nfc@08";
		oppo_devinfo = "/fragment@2/__overlay__/oppo_devinfo";
		oppo_fp = "/fragment@77/__overlay__/fingerprint@0";
		oppo_project = "/fragment@2/__overlay__/oppo_project";
		panel_in1 = "/fragment@67/__overlay__/panel1@0/port/endpoint";
		panel_in2 = "/fragment@67/__overlay__/panel2@0/port/endpoint";
		panel_in3 = "/fragment@67/__overlay__/panel3@0/port/endpoint";
		panel_in4 = "/fragment@67/__overlay__/panel4@0/port/endpoint";
		ship_active_gpio = "/fragment@14/__overlay__/ship_active";
		ship_sleep_gpio = "/fragment@14/__overlay__/ship_sleep";
		speaker_amp = "/fragment@29/__overlay__/speaker_amp@34";
		subpmic_ldo_mtk = "/fragment@46/__overlay__/subpmic_ldo@64";
		subpmic_mtk = "/fragment@46/__overlay__/subpmic@34";
		subpmic_pmic_mtk = "/fragment@46/__overlay__/subpmic_pmic@1a";
		uart0_rx_gpio_input = "/fragment@16/__overlay__/uart0_rx_gpio@gpio61";
		uart0_tx_gpio_input = "/fragment@16/__overlay__/uart0_tx_gpio@gpio62";
		usb_type_c_mtk = "/fragment@46/__overlay__/usb_type_c@4e";
		vibrator0 = "/fragment@2/__overlay__/vibrator@0";
		volume_down_gpio_eint = "/fragment@4/__overlay__/volume_down@0";
		volume_up_gpio_eint = "/fragment@4/__overlay__/volume_up@0";
		vooc_ap_data = "/fragment@2/__overlay__/vooc_ap_data";
		vooc_ap_data_new_function = "/fragment@2/__overlay__/vooc_ap_data_new_function";
		vooc_asic_id_active = "/fragment@21/__overlay__/vooc_asic_id_active";
		vooc_asic_id_sleep = "/fragment@21/__overlay__/vooc_asic_id_sleep";
	};

	fragment@0 {
		target = <0xffffffff>;

		__overlay__ {
		};
	};

	fragment@1 {
		target = <0xffffffff>;

		__overlay__ {
			atag,videolfb-fb_base_h = <0x00>;
			atag,videolfb-fb_base_l = "~`P";
			atag,videolfb-fps = <0x1770>;
			atag,videolfb-islcm_inited = <0x00>;
			atag,videolfb-islcmfound = <0x01>;
			atag,videolfb-lcmname = "nt35595_fhd_dsi_cmd_truly_nt50358_drv";
			atag,videolfb-vramSize = <0x1be0000>;
		};
	};

	fragment@10 {
		target = <0xffffffff>;

		__overlay__ {

			chg {
				aicc_once = <0x01>;
				aicr = <0x7a120>;
				batoc_notify = <0x00>;
				chg_name = "primary_chg";
				compatible = "mediatek,mt6360_pmu_chg";
				cv = <0x426030>;
				en_te = <0x01>;
				en_wdt = <0x01>;
				ichg = <0x1e8480>;
				ieoc = <0x249f0>;
				interrupt-names = "chg_treg_evt\0chg_mivr_evt\0pwr_rdy_evt\0chg_batsysuv_evt\0chg_vsysuv_evt\0chg_vsysov_evt\0chg_vbatov_evt\0chg_vbusov_evt\0chg_tmri\0chg_adpbadi\0chg_rvpi\0chg_aiccmeasl\0wdtmri\0pumpx_donei\0attachi\0chrdet_ext_evt\0hvdcp_det";
				interrupt-parent = <0xffffffff>;
				interrupts = <0x04 0x00 0x06 0x00 0x07 0x00 0x09 0x00 0x0c 0x00 0x0d 0x00 0x0e 0x00 0x0f 0x00 0x1b 0x00 0x1d 0x00 0x1e 0x00 0x20 0x00 0x23 0x00 0x28 0x00 0x30 0x00 0x3c 0x00 0x35 0x00>;
				io-channel-names = "USBID\0VBUSDIV5\0VSYS\0VBAT\0IBUS\0IBAT\0TEMP_JC\0TS";
				io-channels = <0xffffffff 0x00 0xffffffff 0x01 0xffffffff 0x03 0xffffffff 0x04 0xffffffff 0x05 0xffffffff 0x06 0xffffffff 0x08 0xffffffff 0x0a>;
				ircmp_resistor = <0x61a8>;
				ircmp_vclamp = <0x7d00>;
				mivr = <0x432380>;
				post_aicc = <0x01>;
				safety_timer = <0x0c>;
			};
		};
	};

	fragment@11 {
		target = <0xffffffff>;

		__overlay__ {

			ldo3 {
				regulator-always-on;
			};
		};
	};

	fragment@12 {
		target = <0xffffffff>;

		__overlay__ {
			io-channel-names = "auxadc3-chargeric_temp\0auxadc4-usb_temp_v_l\0auxadc5-usb_temp_v_r";
			io-channels = <0xffffffff 0x03 0xffffffff 0x04 0xffffffff 0x05>;
			pinctrl-0 = <0x03>;
			pinctrl-1 = <0x04>;
			pinctrl-2 = <0x05>;
			pinctrl-3 = <0x06>;
			pinctrl-4 = <0x07>;
			pinctrl-5 = <0x08>;
			pinctrl-6 = <0x09>;
			pinctrl-names = "default\0charger_gpio_as_output_low\0charger_gpio_as_output_high\0ship_sleep\0ship_active\0dischg_enable\0dischg_disable";
			qcom,batt_capacity_mah = <0x1388>;
			qcom,charger_current_vooc_ma_normal = <0x708>;
			qcom,charger_hv_thr = <0x16a8>;
			qcom,charger_lv_thr = <0xd48>;
			qcom,charger_recv_thr = <0x157c>;
			qcom,chargerid_support;
			qcom,chargerid_switch-gpio = <0xffffffff 0x28 0x00>;
			qcom,check_batt_full_by_sw;
			qcom,chg_ctrl_by_calling;
			qcom,chg_ctrl_by_camera;
			qcom,chg_ctrl_by_lcd;
			qcom,cold_bat_decidegc = <0x14>;
			qcom,cold_vfloat_over_sw_limit = <0xf96>;
			qcom,cold_vfloat_sw_limit = <0xf5a>;
			qcom,cool_bat_decidegc = <0x32>;
			qcom,cool_vfloat_over_sw_limit = <0x115d>;
			qcom,cool_vfloat_sw_limit = <0x1121>;
			qcom,default_iterm_ma = <0xff>;
			qcom,default_little_cool_vfloat_over_sw_limit = <0x115d>;
			qcom,default_little_cool_vfloat_sw_limit = <0x1121>;
			qcom,default_normal_vfloat_over_sw_limit = <0x115d>;
			qcom,default_normal_vfloat_sw_limit = <0x1121>;
			qcom,default_temp_little_cool_fastchg_current_ma = <0x898>;
			qcom,default_temp_little_cool_vfloat_mv = <0x1153>;
			qcom,default_temp_normal_fastchg_current_ma = <0x898>;
			qcom,default_temp_normal_vfloat_mv = <0x1153>;
			qcom,dischg-gpio = <0xffffffff 0x27 0x00>;
			qcom,external_gauge;
			qcom,ff1_exit_step_ma = <0x226>;
			qcom,ff1_normal_fastchg_ma = <0x5dc>;
			qcom,ff1_warm_exit_step_ma = <0x1f4>;
			qcom,ff1_warm_fastchg_ma = <0x5dc>;
			qcom,ffc1_normal_vfloat_over_sw_limit = <0x11c6>;
			qcom,ffc1_temp_normal_vfloat_mv = <0x11c6>;
			qcom,ffc2_exit_step_ma = <0xfa>;
			qcom,ffc2_normal_fastchg_ma = <0x4b0>;
			qcom,ffc2_normal_vfloat_over_sw_limit = <0x11c6>;
			qcom,ffc2_normal_vfloat_sw_limit = <0x117b>;
			qcom,ffc2_temp_high_decidegc = <0x190>;
			qcom,ffc2_temp_low_decidegc = <0x78>;
			qcom,ffc2_temp_normal_vfloat_mv = <0x11c6>;
			qcom,ffc2_temp_warm_decidegc = <0x15e>;
			qcom,ffc2_warm_exit_step_ma = <0xfa>;
			qcom,ffc2_warm_fastchg_ma = <0x4e2>;
			qcom,ffc2_warm_vfloat_sw_limit = <0x117b>;
			qcom,ffc_normal_vfloat_over_sw_limit = <0x11c6>;
			qcom,ffc_normal_vfloat_sw_limit = <0x117b>;
			qcom,ffc_support;
			qcom,ffc_temp_normal_vfloat_mv = <0x11c6>;
			qcom,ffc_warm_vfloat_sw_limit = <0x117b>;
			qcom,hot_bat_decidegc = <0x212>;
			qcom,input_current_calling_ma = <0x5dc>;
			qcom,input_current_camera_ma = <0x4b0>;
			qcom,input_current_cdp_ma = <0x5dc>;
			qcom,input_current_charger_ma = <0x8fc>;
			qcom,input_current_led_ma = <0x4b0>;
			qcom,input_current_led_ma_high = <0x4b0>;
			qcom,input_current_led_ma_normal = <0x8fc>;
			qcom,input_current_led_ma_warm = <0x5dc>;
			qcom,input_current_usb_ma = <0x1f4>;
			qcom,input_current_vooc_led_ma_high = <0x4b0>;
			qcom,input_current_vooc_led_ma_normal = <0xe10>;
			qcom,input_current_vooc_led_ma_warm = <0x708>;
			qcom,input_current_vooc_ma_high = <0x898>;
			qcom,input_current_vooc_ma_normal = <0xe10>;
			qcom,input_current_vooc_ma_warm = <0xc80>;
			qcom,iterm_disabled = <0x00>;
			qcom,iterm_ma = <0xff>;
			qcom,led_high_bat_decidegc = <0x172>;
			qcom,led_warm_bat_decidegc = <0x15e>;
			qcom,little_cold_bat_decidegc = <0x00>;
			qcom,little_cold_vfloat_over_sw_limit = <0x115d>;
			qcom,little_cold_vfloat_sw_limit = <0x1121>;
			qcom,little_cool_bat_decidegc = <0x78>;
			qcom,little_cool_vfloat_over_sw_limit = <0x115d>;
			qcom,little_cool_vfloat_sw_limit = <0x1121>;
			qcom,lpd-disable;
			qcom,max_chg_time_sec = <0x11940>;
			qcom,new_ui_warning_support;
			qcom,non_normal_vterm_hw_inc = <0x12>;
			qcom,non_standard_fastchg_current_ma = <0x200>;
			qcom,non_standard_vfloat_mv = <0xf8c>;
			qcom,non_standard_vfloat_over_sw_limit = <0xf96>;
			qcom,non_standard_vfloat_sw_limit = <0xf5a>;
			qcom,normal_bat_decidegc = <0xa0>;
			qcom,normal_vfloat_over_sw_limit = <0x115d>;
			qcom,normal_vfloat_sw_limit = <0x1121>;
			qcom,normal_vterm_hw_inc = <0x12>;
			qcom,overtemp_bat_decidegc = <0x15e>;
			qcom,pd_input_current_charger_ma = <0xce4>;
			qcom,pd_temp_cool_fastchg_current_ma_high = <0x8fc>;
			qcom,pd_temp_cool_fastchg_current_ma_low = <0x8fc>;
			qcom,pd_temp_little_cold_fastchg_current_ma_high = <0x8fc>;
			qcom,pd_temp_little_cold_fastchg_current_ma_low = <0x578>;
			qcom,pd_temp_little_cool_fastchg_current_ma = <0xce4>;
			qcom,pd_temp_normal_fastchg_current_ma = <0xce4>;
			qcom,pd_temp_warm_fastchg_current_ma = <0x578>;
			qcom,qc_input_current_charger_ma = <0x7d0>;
			qcom,qc_temp_cool_fastchg_current_ma_high = <0x7d0>;
			qcom,qc_temp_cool_fastchg_current_ma_low = <0x7d0>;
			qcom,qc_temp_little_cold_fastchg_current_ma_high = <0x7d0>;
			qcom,qc_temp_little_cold_fastchg_current_ma_low = <0x578>;
			qcom,qc_temp_little_cool_fastchg_current_ma = <0x7d0>;
			qcom,qc_temp_normal_fastchg_current_ma = <0x7d0>;
			qcom,qc_temp_warm_fastchg_current_ma = <0x578>;
			qcom,recharge-mv = <0x64>;
			qcom,removed_bat_decidegc = <0xbe>;
			qcom,ship-gpio = <0xffffffff 0x22 0x00>;
			qcom,short_c_bat_cv_mv = <0x10ea>;
			qcom,short_c_bat_fastchg_current_ma = <0x200>;
			qcom,short_c_bat_vfloat_mv = <0xed8>;
			qcom,short_c_bat_vfloat_sw_limit = <0xea6>;
			qcom,smart_charging_screenoff;
			qcom,sw_vfloat_over_protect_enable;
			qcom,temp_cold_fastchg_current_ma = <0x15e>;
			qcom,temp_cold_vfloat_mv = <0xf8c>;
			qcom,temp_cool_fastchg_current_ma_high = <0x8fc>;
			qcom,temp_cool_fastchg_current_ma_low = <0x8fc>;
			qcom,temp_cool_vfloat_mv = <0x1153>;
			qcom,temp_little_cold_fastchg_current_ma = <0x578>;
			qcom,temp_little_cold_fastchg_current_ma_high = <0x8fc>;
			qcom,temp_little_cold_fastchg_current_ma_low = <0x578>;
			qcom,temp_little_cold_vfloat_mv = <0x1153>;
			qcom,temp_little_cool_fastchg_current_ma = <0x8fc>;
			qcom,temp_little_cool_vfloat_mv = <0x1153>;
			qcom,temp_normal_fastchg_current_ma = <0x8fc>;
			qcom,temp_normal_vfloat_mv = <0x1153>;
			qcom,temp_warm_fastchg_current_ma = <0x578>;
			qcom,temp_warm_fastchg_current_ma_led_on = <0x1f4>;
			qcom,temp_warm_vfloat_mv = <0x1022>;
			qcom,vbatt_full_thr = <0x1130>;
			qcom,vbatt_hv_thr = <0x11c6>;
			qcom,vbatt_num = <0x01>;
			qcom,vbatt_pdqc_to_5v_thr = <0x1054>;
			qcom,vbatt_power_off = <0xce4>;
			qcom,vbatt_soc_1 = <0xd52>;
			qcom,vfloat_step_mv = <0x08>;
			qcom,vooc_project = <0x01>;
			qcom,vooc_temp_bat_hot_decidegc = <0x1b8>;
			qcom,vooc_temp_bat_normal_decidegc = <0x15e>;
			qcom,vooc_temp_bat_warm_decidegc = <0x172>;
			qcom,warm_bat_decidegc = <0x1c2>;
			qcom,warm_vfloat_over_sw_limit = <0x102c>;
			qcom,warm_vfloat_sw_limit = <0xff0>;
		};
	};

	fragment@13 {
		target = <0xffffffff>;

		__overlay__ {
			regulator-enable-ramp-delay = <0xf0>;
			regulator-max-microvolt = <0x2dc6c0>;
			regulator-min-microvolt = <0x2dc6c0>;
			regulator-name = "vio28";
		};
	};

	fragment@14 {
		target = <0xffffffff>;

		__overlay__ {

			charger_gpio_as_output_high {
				phandle = <0x05>;

				pins_cmd_dat {
					output-high;
					pinmux = <0x2800>;
					slew-rate = <0x01>;
				};
			};

			charger_gpio_as_output_low {
				phandle = <0x04>;

				pins_cmd_dat {
					output-low;
					pinmux = <0x2800>;
					slew-rate = <0x01>;
				};
			};

			dischg_disable {
				phandle = <0x09>;

				pins_cmd_dat {
					bias-pull-down = <0x00>;
					output-low;
					pinmux = <0x2700>;
					slew-rate = <0x01>;
				};
			};

			dischg_enable {
				phandle = <0x08>;

				pins_cmd_dat {
					bias-pull-up = <0x00>;
					output-high;
					pinmux = <0x2700>;
					slew-rate = <0x01>;
				};
			};

			eint0default {
				phandle = <0x03>;
			};

			ship_active {
				phandle = <0x07>;

				pins_cmd_dat {
					output-high;
					pinmux = <0x2200>;
					slew-rate = <0x01>;
				};
			};

			ship_sleep {
				phandle = <0x06>;

				pins_cmd_dat {
					output-low;
					pinmux = <0x2200>;
					slew-rate = <0x01>;
				};
			};
		};
	};

	fragment@15 {
		target = <0xffffffff>;

		__overlay__ {
			pinctrl-0 = <0x0a>;
			pinctrl-1 = <0x0b>;
			pinctrl-names = "uart0_rx_gpio\0uart0_tx_gpio";
			status = "okay";
		};
	};

	fragment@16 {
		target = <0xffffffff>;

		__overlay__ {

			uart0_rx_gpio@gpio61 {
				phandle = <0x0a>;

				pins_cmd_dat {
					bias-pull-down = <0x00>;
					input-enable;
					pinmux = <0x3d00>;
					slew-rate = <0x00>;
				};
			};

			uart0_tx_gpio@gpio62 {
				phandle = <0x0b>;

				pins_cmd_dat {
					bias-pull-down = <0x00>;
					input-enable;
					pinmux = <0x3e00>;
					slew-rate = <0x00>;
				};
			};
		};
	};

	fragment@17 {
		target = <0xffffffff>;

		__overlay__ {
			DISABLE_MTKBATTERY = <0x01>;
		};
	};

	fragment@18 {
		target = <0xffffffff>;

		__overlay__ {
			pinctrl-0 = <0x0c>;
			pinctrl-1 = <0x0d>;
			pinctrl-names = "i2c-state\0output-low-state";
		};
	};

	fragment@19 {
		target = <0xffffffff>;

		__overlay__ {

			i2c7_sda_i2c_state {
				phandle = <0x0c>;

				pins_cmd_dat {
					bias-pull-up = <0x0b>;
					pinmux = <0x7001>;
					slew-rate = <0x00>;
				};
			};

			i2c7_sda_output_low_state {
				phandle = <0x0d>;

				pins_cmd_dat {
					output-low;
					pinmux = <0x7000>;
					slew-rate = <0x01>;
				};
			};
		};
	};

	fragment@2 {
		target = <0xffffffff>;

		__overlay__ {

			kpd_volume_down {
				compatible = "mediatek, VOLUME_DOWN-eint";
				debounce = <0x7d00>;
				interrupt-parent = <0xffffffff>;
				interrupts = <0x50 0x02 0x50 0x00>;
				phandle = <0x7a>;
				status = "okay";
			};

			kpd_volume_up {
				compatible = "mediatek, VOLUME_UP-eint";
				debounce = <0x7d00>;
				interrupt-parent = <0xffffffff>;
				interrupts = <0x01 0x02 0x01 0x00>;
				phandle = <0x79>;
				status = "okay";
			};

			led@0 {
				compatible = "mediatek,red";
				data = <0x01>;
				led_mode = <0x00>;
				phandle = <0x71>;
				pwm_config = <0x00 0x00 0x00 0x00 0x00>;
			};

			led@1 {
				compatible = "mediatek,green";
				data = <0x01>;
				led_mode = <0x00>;
				phandle = <0x72>;
				pwm_config = <0x00 0x00 0x00 0x00 0x00>;
			};

			led@2 {
				compatible = "mediatek,blue";
				data = <0x01>;
				led_mode = <0x00>;
				phandle = <0x73>;
				pwm_config = <0x00 0x00 0x00 0x00 0x00>;
			};

			led@3 {
				compatible = "mediatek,jogball-backlight";
				data = <0x01>;
				led_mode = <0x00>;
				phandle = <0x74>;
				pwm_config = <0x00 0x00 0x00 0x00 0x00>;
			};

			led@4 {
				compatible = "mediatek,keyboard-backlight";
				data = <0x01>;
				led_mode = <0x00>;
				phandle = <0x75>;
				pwm_config = <0x00 0x00 0x00 0x00 0x00>;
			};

			led@5 {
				compatible = "mediatek,button-backlight";
				data = <0x01>;
				led_mode = <0x00>;
				phandle = <0x76>;
				pwm_config = <0x00 0x00 0x00 0x00 0x00>;
			};

			led@6 {
				compatible = "mediatek,lcd-backlight";
				data = <0x01>;
				led_mode = <0x04>;
				phandle = <0x77>;
				pwm_config = <0x00 0x01 0x00 0x00 0x00>;
			};

			oppo_devinfo {
				Hw,sim_det = <0xffffffff 0x4d 0x00>;
				compatible = "oppo, device_info";
				phandle = <0x7c>;
			};

			oppo_project {
				compatible = "oppo,oppo_project";
				phandle = <0x7b>;
			};

			vibrator@0 {
				compatible = "mediatek,vibrator";
				phandle = <0x78>;
				vib_limit = <0x00>;
				vib_timer = <0x1e>;
				vib_vol = <0x0b>;
			};

			vooc_ap_data {
				compatible = "mediatek, VOOC_AP_DATA-eint";
				interrupts = <0x3f 0x02 0x3f 0x00>;
				phandle = <0x7d>;
			};

			vooc_ap_data_new_function {
				compatible = "mediatek, VOOC_EINT_NEW_FUNCTION";
				phandle = <0x7e>;
			};
		};
	};

	fragment@20 {
		target = <0xffffffff>;

		__overlay__ {
			status = "okay";

			bq27541-battery@55 {
				compatible = "oppo,bq27541-battery";
				qcom,modify-soc-smooth;
				qcom,test = <0x05>;
				reg = <0x55 0x00>;
				status = "okay";
			};

			rk826_fastcg@0a {
				compatible = "oppo,rk826-fastcg";
				pinctrl-0 = <0x0e>;
				pinctrl-1 = <0x0f>;
				pinctrl-10 = <0x14>;
				pinctrl-11 = <0x15>;
				pinctrl-12 = <0x16>;
				pinctrl-13 = <0x17>;
				pinctrl-14 = <0x18>;
				pinctrl-15 = <0x19>;
				pinctrl-2 = <0x0e>;
				pinctrl-3 = <0x0f>;
				pinctrl-4 = <0x0e>;
				pinctrl-5 = <0x0f>;
				pinctrl-6 = <0x10>;
				pinctrl-7 = <0x11>;
				pinctrl-8 = <0x12>;
				pinctrl-9 = <0x13>;
				pinctrl-names = "switch1_act_switch2_act\0switch1_sleep_switch2_sleep\0switch1_act_switch3_act\0switch1_sleep_switch3_sleep\0switch1_act_switch2_sleep\0switch1_sleep_switch2_act\0clock_active\0clock_sleep\0data_active\0data_sleep\0reset_active\0reset_sleep\0charging_switch1_ctr1_active\0charging_switch1_ctr1_sleep\0vooc_asic_id_active\0vooc_asic_id_sleep";
				qcom,charging_clock-gpio = <0xffffffff 0x40 0x00>;
				qcom,charging_data-gpio = <0xffffffff 0x3f 0x00>;
				qcom,charging_reset-gpio = <0xffffffff 0x84 0x00>;
				qcom,charging_switch1-gpio = <0xffffffff 0x20 0x00>;
				qcom,charging_switch1_ctr1-gpio = <0xffffffff 0x4c 0x00>;
				qcom,oppo_batt_4400mv;
				qcom,vooc-fw-type = <0x01>;
				qcom,vooc-high-soc = <0x55>;
				qcom,vooc-high-temp = <0x1ae>;
				qcom,vooc-low-soc = <0x01>;
				qcom,vooc-low-temp = <0x32>;
				qcom,vooc-normal-to-little-cool-current = <0x04>;
				qcom,vooc_asic_id-gpio = <0xffffffff 0x86 0x00>;
				qcom,vooc_fw_update_newmethod;
				qcom,vooc_multistep_adjust_current_support;
				qcom,vooc_multistep_initial_batt_temp = <0x3e8>;
				qcom,vooc_over_high_or_low_current = <0x02>;
				qcom,vooc_strategy1_batt_high_temp0 = <0x19a>;
				qcom,vooc_strategy1_batt_high_temp1 = <0x1a9>;
				qcom,vooc_strategy1_batt_high_temp2 = <0x1b3>;
				qcom,vooc_strategy1_batt_low_temp0 = <0x186>;
				qcom,vooc_strategy1_batt_low_temp1 = <0x19a>;
				qcom,vooc_strategy1_batt_low_temp2 = <0x1ae>;
				qcom,vooc_strategy1_high_current0 = <0x04>;
				qcom,vooc_strategy1_high_current1 = <0x03>;
				qcom,vooc_strategy1_high_current2 = <0x02>;
				qcom,vooc_strategy1_low_current0 = <0x06>;
				qcom,vooc_strategy1_low_current1 = <0x05>;
				qcom,vooc_strategy1_low_current2 = <0x03>;
				qcom,vooc_strategy2_batt_up_down_temp2 = <0x17c>;
				qcom,vooc_strategy2_batt_up_down_temp4 = <0x190>;
				qcom,vooc_strategy2_batt_up_temp1 = <0x177>;
				qcom,vooc_strategy2_batt_up_temp3 = <0x186>;
				qcom,vooc_strategy2_batt_up_temp5 = <0x19a>;
				qcom,vooc_strategy2_batt_up_temp6 = <0x19f>;
				qcom,vooc_strategy2_high0_current = <0x06>;
				qcom,vooc_strategy2_high1_current = <0x06>;
				qcom,vooc_strategy2_high2_current = <0x06>;
				qcom,vooc_strategy2_high3_current = <0x06>;
				qcom,vooc_strategy_normal_current = <0x06>;
				reg = <0x0a 0x00>;
				status = "okay";
			};
		};
	};

	fragment@21 {
		target = <0xffffffff>;

		__overlay__ {

			charging_clock_active {
				phandle = <0x10>;

				pins_cmd_dat {
					bias-pull-up = <0x00>;
					pinmux = <0x4000>;
					slew-rate = <0x00>;
				};
			};

			charging_clock_sleep {
				phandle = <0x11>;

				pins_cmd_dat {
					bias-pull-down = <0x00>;
					pinmux = <0x4000>;
					slew-rate = <0x00>;
				};
			};

			charging_data_active {
				phandle = <0x12>;

				pins_cmd_dat {
					bias-pull-down = <0x00>;
					pinmux = <0x3f00>;
					slew-rate = <0x00>;
				};
			};

			charging_data_sleep {
				phandle = <0x13>;

				pins_cmd_dat {
					bias-pull-down = <0x00>;
					pinmux = <0x3f00>;
					slew-rate = <0x00>;
				};
			};

			charging_reset_active {
				phandle = <0x14>;

				pins_cmd_dat {
					output-high;
					pinmux = <0x8400>;
					slew-rate = <0x01>;
				};
			};

			charging_reset_sleep {
				phandle = <0x15>;

				pins_cmd_dat {
					output-low;
					pinmux = <0x8400>;
					slew-rate = <0x01>;
				};
			};

			charging_switch1_active {
				phandle = <0x0e>;

				pins_cmd_dat {
					output-high;
					pinmux = <0x2000>;
					slew-rate = <0x01>;
				};
			};

			charging_switch1_ctr1_active {
				phandle = <0x16>;

				pins_cmd_dat {
					output-high;
					pinmux = <0x4c00>;
					slew-rate = <0x01>;
				};
			};

			charging_switch1_ctr1_sleep {
				phandle = <0x17>;

				pins_cmd_dat {
					output-low;
					pinmux = <0x4c00>;
					slew-rate = <0x01>;
				};
			};

			charging_switch1_sleep {
				phandle = <0x0f>;

				pins_cmd_dat {
					output-low;
					pinmux = <0x2000>;
					slew-rate = <0x01>;
				};
			};

			vooc_asic_id_active {
				phandle = <0x18>;

				pins_cmd_dat {
					bias-pull-up;
					input-enable;
					pinmux = <0x8600>;
					slew-rate = <0x00>;
				};
			};

			vooc_asic_id_sleep {
				phandle = <0x19>;

				pins_cmd_dat {
					bias-pull-down;
					input-enable;
					pinmux = <0x8600>;
					slew-rate = <0x00>;
				};
			};
		};
	};

	fragment@22 {
		target = <0xffffffff>;

		__overlay__ {

			nfc_st21@8 {
				compatible = "st,st21nfc";
				gpio-clkreq-std = <0xffffffff 0x51 0x00>;
				gpio-irq-std = <0xffffffff 0x05 0x00>;
				gpio-rst-std = <0xffffffff 0x0b 0x00>;
				reg = <0x08>;
				status = "okay";
			};
		};
	};

	fragment@23 {
		target = <0xffffffff>;

		__overlay__ {

			st54spi@0 {
				compatible = "st,st54spi";
				gpio-power = <0x08>;
				gpio-power-std = <0xffffffff 0x08 0x00>;
				reg = <0x00>;
				spi-max-frequency = <0xf4240>;
				status = "okay";
			};
		};
	};

	fragment@24 {
		target = <0xffffffff>;

		__overlay__ {

			consys_default {
				phandle = <0x1a>;
			};

			gpslna@0 {
				phandle = <0x1b>;

				pins_cmd_dat {
					output-low;
					pinmux = <0x5700>;
				};
			};

			gpslna@1 {
				phandle = <0x1c>;

				pins_cmd_dat {
					pinmux = <0x5702>;
				};
			};

			gpslna@2 {
				phandle = <0x1d>;

				pins_cmd_dat {
					output-low;
					pinmux = <0x5700>;
				};
			};
		};
	};

	fragment@25 {
		target = <0xffffffff>;

		__overlay__ {
			pinctrl-0 = <0x1a>;
			pinctrl-1 = <0x1b>;
			pinctrl-2 = <0x1c>;
			pinctrl-3 = <0x1d>;
			pinctrl-names = "default\0gps_lna_state_init\0gps_lna_state_oh\0gps_lna_state_ol";
			status = "okay";
		};
	};

	fragment@26 {
		target = <0xffffffff>;

		__overlay__ {
			status = "okay";

			touchscreen@0 {
				black_gesture_support;
				black_gesture_test_support;
				charger_pump_support;
				chip-name = "OPPO_TP_NOFLASH";
				compatible = "oppo,tp_noflash";
				esd_handle_support;
				fw_edge_limit_support;
				fw_update_app_support;
				game_switch_support;
				headset_pump_support;
				incell_screen;
				interrupt-parent = <0xffffffff>;
				interrupts = <0x0e 0x02 0x0e 0x00>;
				irq-gpio = <0xffffffff 0x0e 0x2002>;
				lcd_trigger_load_tp_fw_support;
				noflash_support;
				pinctrl-0 = <0x1e 0x1f 0x20>;
				pinctrl-1 = <0x21 0x22>;
				pinctrl-names = "default\0suspend";
				pressure_report_support;
				reg = <0x00>;
				reset-gpio = <0xffffffff 0x2b 0x00>;
				smart_gesture_support;
				spi-max-frequency = <0x927c00>;
				status = "ok";
				touchpanel,button-type = <0x04>;
				touchpanel,display-coords = <0x438 0x960>;
				touchpanel,max-num-support = <0x0a>;
				touchpanel,panel-coords = <0x438 0x960>;
				touchpanel,touchmajor-limit = <0x00 0x36>;
				touchpanel,tx-rx-num = <0x10 0x24>;
			};
		};
	};

	fragment@27 {
		target = <0xffffffff>;

		__overlay__ {

			eintdefault {
				phandle = <0x7f>;
			};

			i2cmode_default {
				phandle = <0x85>;

				pins_cmd_dat {
					pinmux = <0x6101 0x6201>;
				};
			};

			int1_active {
				phandle = <0x1e>;

				pins_cmd_dat {
					bias-pull-up = <0x0b>;
					pinmux = <0xe00>;
					slew-rate = <0x00>;
				};
			};

			int1_suspend {
				phandle = <0x21>;

				pins_cmd_dat {
					output-low;
					pinmux = <0xe00>;
					slew-rate = <0x01>;
				};
			};

			int_active {
				phandle = <0x81>;

				pins_cmd_dat {
					bias-pull-up = <0x0b>;
					pinmux = <0xe00>;
					slew-rate = <0x00>;
				};
			};

			int_suspend {
				phandle = <0x83>;

				pins_cmd_dat {
					output-low;
					pinmux = <0xe00>;
					slew-rate = <0x01>;
				};
			};

			pins_default {
				phandle = <0x80>;
			};

			reset1_active {
				phandle = <0x1f>;

				pins_cmd_dat {
					output-high;
					pinmux = <0x2b00>;
					slew-rate = <0x01>;
				};
			};

			reset1_suspend {
				phandle = <0x22>;

				pins_cmd_dat {
					output-low;
					pinmux = <0x2b00>;
					slew-rate = <0x01>;
				};
			};

			reset_active {
				phandle = <0x82>;

				pins_cmd_dat {
					output-high;
					pinmux = <0x2b00>;
					slew-rate = <0x01>;
				};
			};

			reset_suspend {
				phandle = <0x84>;

				pins_cmd_dat {
					output-low;
					pinmux = <0x2b00>;
					slew-rate = <0x01>;
				};
			};

			spimode_default {
				phandle = <0x20>;

				pins_cmd_dat {
					drive-strength = <0x04>;
					pinmux = <0xc02 0xd02 0x6102 0x6202>;
				};
			};
		};
	};

	fragment@28 {
		target = <0xffffffff>;

		__overlay__ {

			mediatek,speaker-codec {
				sound-dai = <0x23>;
			};
		};
	};

	fragment@29 {
		target = <0xffffffff>;

		__overlay__ {

			speaker_amp@34 {
				#sound-dai-cells = <0x00>;
				compatible = "mediatek,speaker_amp";
				phandle = <0x23>;
				reg = <0x34>;
				status = "okay";
			};
		};
	};

	fragment@3 {
		target = <0xffffffff>;

		__overlay__ {
			keypad,volume-down = <0xffffffff 0x50 0x00>;
			keypad,volume-up = <0xffffffff 0x01 0x00>;
			pinctrl-0 = <0x01>;
			pinctrl-1 = <0x02>;
			pinctrl-names = "volume_up_as_int\0volume_down_as_int";
			status = "okay";
		};
	};

	fragment@30 {
		target = <0xffffffff>;

		__overlay__ {
			compatible = "mediatek, swtp-eint";
			debounce = <0x7d000>;
		};
	};

	fragment@31 {
		target = <0xffffffff>;

		__overlay__ {

			cam0@0 {
				phandle = <0x25>;

				pins_cmd_dat {
					output-low;
					pinmux = <0x3600>;
					slew-rate = <0x01>;
				};
			};

			cam0@1 {
				phandle = <0x26>;

				pins_cmd_dat {
					output-high;
					pinmux = <0x3600>;
					slew-rate = <0x01>;
				};
			};

			cam0@vcam0 {
				phandle = <0x2f>;

				pins_cmd_dat {
					output-low;
					pinmux = <0x3700>;
					slew-rate = <0x01>;
				};
			};

			cam0@vcam1 {
				phandle = <0x30>;

				pins_cmd_dat {
					output-high;
					pinmux = <0x3700>;
					slew-rate = <0x01>;
				};
			};

			cam0@vcam2 {
				phandle = <0x31>;

				pins_cmd_dat {
					output-low;
					pinmux = <0x5b00>;
					slew-rate = <0x01>;
				};
			};

			cam0@vcam3 {
				phandle = <0x32>;

				pins_cmd_dat {
					output-high;
					pinmux = <0x5b00>;
					slew-rate = <0x01>;
				};
			};

			cam1@0 {
				phandle = <0x27>;

				pins_cmd_dat {
					output-low;
					pinmux = <0x3c00>;
					slew-rate = <0x01>;
				};
			};

			cam1@1 {
				phandle = <0x28>;

				pins_cmd_dat {
					output-high;
					pinmux = <0x3c00>;
					slew-rate = <0x01>;
				};
			};

			cam1@vcam0 {
				phandle = <0x33>;

				pins_cmd_dat {
					output-low;
					pinmux = <0x8500>;
					slew-rate = <0x01>;
				};
			};

			cam1@vcam1 {
				phandle = <0x34>;

				pins_cmd_dat {
					output-high;
					pinmux = <0x8500>;
					slew-rate = <0x01>;
				};
			};

			cam1@vcam2 {
				phandle = <0x35>;

				pins_cmd_dat {
					output-low;
					pinmux = <0x3b00>;
					slew-rate = <0x01>;
				};
			};

			cam1@vcam3 {
				phandle = <0x36>;

				pins_cmd_dat {
					output-high;
					pinmux = <0x3b00>;
					slew-rate = <0x01>;
				};
			};

			cam2@0 {
				phandle = <0x29>;

				pins_cmd_dat {
					output-low;
					pinmux = <0x3800>;
					slew-rate = <0x01>;
				};
			};

			cam2@1 {
				phandle = <0x2a>;

				pins_cmd_dat {
					output-high;
					pinmux = <0x3800>;
					slew-rate = <0x01>;
				};
			};

			cam2@vcam2 {
				phandle = <0x37>;

				pins_cmd_dat {
					output-low;
					pinmux = <0x3b00>;
					slew-rate = <0x01>;
				};
			};

			cam2@vcam3 {
				phandle = <0x38>;

				pins_cmd_dat {
					output-high;
					pinmux = <0x3b00>;
					slew-rate = <0x01>;
				};
			};

			cam3@0 {
				phandle = <0x2b>;

				pins_cmd_dat {
					output-low;
					pinmux = <0x3500>;
					slew-rate = <0x01>;
				};
			};

			cam3@1 {
				phandle = <0x2c>;

				pins_cmd_dat {
					output-high;
					pinmux = <0x3500>;
					slew-rate = <0x01>;
				};
			};

			cam3@vcam2 {
				phandle = <0x39>;

				pins_cmd_dat {
					output-low;
					pinmux = <0x3b00>;
					slew-rate = <0x01>;
				};
			};

			cam3@vcam3 {
				phandle = <0x3a>;

				pins_cmd_dat {
					output-high;
					pinmux = <0x3b00>;
					slew-rate = <0x01>;
				};
			};

			cam4@0 {
				phandle = <0x2d>;

				pins_cmd_dat {
					output-low;
					pinmux = <0x3a00>;
					slew-rate = <0x01>;
				};
			};

			cam4@1 {
				phandle = <0x2e>;

				pins_cmd_dat {
					output-high;
					pinmux = <0x3a00>;
					slew-rate = <0x01>;
				};
			};

			cam4@vcam2 {
				phandle = <0x3b>;

				pins_cmd_dat {
					output-low;
					pinmux = <0x3b00>;
					slew-rate = <0x01>;
				};
			};

			cam4@vcam3 {
				phandle = <0x3c>;

				pins_cmd_dat {
					output-high;
					pinmux = <0x3b00>;
					slew-rate = <0x01>;
				};
			};

			camdefault {
				phandle = <0x24>;
			};

			camera_dvdd_switch_output_high@gpio88 {
				phandle = <0x58>;

				pins_cmd_dat {
					output-high;
					pinmux = <0x5800>;
				};
			};

			camera_dvdd_switch_output_low@gpio88 {
				phandle = <0x59>;

				pins_cmd_dat {
					output-low;
					pinmux = <0x5800>;
				};
			};

			camera_mipi_switch1_output_high@gpio38 {
				phandle = <0x56>;

				pins_cmd_dat {
					output-high;
					pinmux = <0x2600>;
				};
			};

			camera_mipi_switch1_output_low@gpio38 {
				phandle = <0x57>;

				pins_cmd_dat {
					output-low;
					pinmux = <0x2600>;
				};
			};

			camera_pins_cam0_mclk_2ma {
				phandle = <0x3e>;

				pins_cmd_dat {
					drive-strength = <0x00>;
					pinmux = <0x3101>;
				};
			};

			camera_pins_cam0_mclk_4ma {
				phandle = <0x3f>;

				pins_cmd_dat {
					drive-strength = <0x01>;
					pinmux = <0x3101>;
				};
			};

			camera_pins_cam0_mclk_6ma {
				phandle = <0x40>;

				pins_cmd_dat {
					drive-strength = <0x02>;
					pinmux = <0x3101>;
				};
			};

			camera_pins_cam0_mclk_8ma {
				phandle = <0x41>;

				pins_cmd_dat {
					drive-strength = <0x03>;
					pinmux = <0x3101>;
				};
			};

			camera_pins_cam0_mclk_off {
				phandle = <0x3d>;

				pins_cmd_dat {
					drive-strength = <0x01>;
					pinmux = <0x3100>;
				};
			};

			camera_pins_cam1_mclk_2ma {
				phandle = <0x43>;

				pins_cmd_dat {
					drive-strength = <0x00>;
					pinmux = <0x3401>;
				};
			};

			camera_pins_cam1_mclk_4ma {
				phandle = <0x44>;

				pins_cmd_dat {
					drive-strength = <0x01>;
					pinmux = <0x3401>;
				};
			};

			camera_pins_cam1_mclk_6ma {
				phandle = <0x45>;

				pins_cmd_dat {
					drive-strength = <0x02>;
					pinmux = <0x3401>;
				};
			};

			camera_pins_cam1_mclk_8ma {
				phandle = <0x46>;

				pins_cmd_dat {
					drive-strength = <0x03>;
					pinmux = <0x3401>;
				};
			};

			camera_pins_cam1_mclk_off {
				phandle = <0x42>;

				pins_cmd_dat {
					drive-strength = <0x01>;
					pinmux = <0x3400>;
				};
			};

			camera_pins_cam2_mclk_2ma {
				phandle = <0x48>;

				pins_cmd_dat {
					drive-strength = <0x00>;
					pinmux = <0x3201>;
				};
			};

			camera_pins_cam2_mclk_4ma {
				phandle = <0x49>;

				pins_cmd_dat {
					drive-strength = <0x01>;
					pinmux = <0x3201>;
				};
			};

			camera_pins_cam2_mclk_6ma {
				phandle = <0x4a>;

				pins_cmd_dat {
					drive-strength = <0x02>;
					pinmux = <0x3201>;
				};
			};

			camera_pins_cam2_mclk_8ma {
				phandle = <0x4b>;

				pins_cmd_dat {
					drive-strength = <0x03>;
					pinmux = <0x3201>;
				};
			};

			camera_pins_cam2_mclk_off {
				phandle = <0x47>;

				pins_cmd_dat {
					drive-strength = <0x01>;
					pinmux = <0x3200>;
				};
			};

			camera_pins_cam3_mclk_2ma {
				phandle = <0x4d>;

				pins_cmd_dat {
					drive-strength = <0x00>;
					pinmux = <0x3301>;
				};
			};

			camera_pins_cam3_mclk_4ma {
				phandle = <0x4e>;

				pins_cmd_dat {
					drive-strength = <0x01>;
					pinmux = <0x3301>;
				};
			};

			camera_pins_cam3_mclk_6ma {
				phandle = <0x4f>;

				pins_cmd_dat {
					drive-strength = <0x02>;
					pinmux = <0x3301>;
				};
			};

			camera_pins_cam3_mclk_8ma {
				phandle = <0x50>;

				pins_cmd_dat {
					drive-strength = <0x03>;
					pinmux = <0x3301>;
				};
			};

			camera_pins_cam3_mclk_off {
				phandle = <0x4c>;

				pins_cmd_dat {
					drive-strength = <0x01>;
					pinmux = <0x3300>;
				};
			};

			camera_pins_cam4_mclk_2ma {
				phandle = <0x52>;

				pins_cmd_dat {
					drive-strength = <0x00>;
					pinmux = <0x3301>;
				};
			};

			camera_pins_cam4_mclk_4ma {
				phandle = <0x53>;

				pins_cmd_dat {
					drive-strength = <0x01>;
					pinmux = <0x3301>;
				};
			};

			camera_pins_cam4_mclk_6ma {
				phandle = <0x54>;

				pins_cmd_dat {
					drive-strength = <0x02>;
					pinmux = <0x3301>;
				};
			};

			camera_pins_cam4_mclk_8ma {
				phandle = <0x55>;

				pins_cmd_dat {
					drive-strength = <0x03>;
					pinmux = <0x3301>;
				};
			};

			camera_pins_cam4_mclk_off {
				phandle = <0x51>;

				pins_cmd_dat {
					drive-strength = <0x01>;
					pinmux = <0x3300>;
				};
			};
		};
	};

	fragment@32 {
		target = <0xffffffff>;

		__overlay__ {
			cam0_enable_sensor = "s5kgm1st_mipi_raw ov16a10_mipi_raw";
			cam0_vcamio-supply = <0xffffffff>;
			cam1_enable_sensor = "s5k3p9sp_mipi_raw";
			cam1_vcamio-supply = <0xffffffff>;
			cam2_enable_sensor = "hi846_mipi_raw";
			cam2_vcamd-supply = <0xffffffff>;
			cam2_vcamio-supply = <0xffffffff>;
			cam3_enable_sensor = "ov02b1b_mipi_raw gc02k_mipi_raw";
			cam3_vcamio-supply = <0xffffffff>;
			cam4_enable_sensor = "gc02k_mipi_raw";
			cam4_vcamio-supply = <0xffffffff>;
			pinctrl-0 = <0x24>;
			pinctrl-1 = <0x25>;
			pinctrl-10 = <0x2e>;
			pinctrl-11 = <0x2f>;
			pinctrl-12 = <0x30>;
			pinctrl-13 = <0x31>;
			pinctrl-14 = <0x32>;
			pinctrl-15 = <0x33>;
			pinctrl-16 = <0x34>;
			pinctrl-17 = <0x35>;
			pinctrl-18 = <0x36>;
			pinctrl-19 = <0x37>;
			pinctrl-2 = <0x26>;
			pinctrl-20 = <0x38>;
			pinctrl-21 = <0x39>;
			pinctrl-22 = <0x3a>;
			pinctrl-23 = <0x3b>;
			pinctrl-24 = <0x3c>;
			pinctrl-25 = <0x3d>;
			pinctrl-26 = <0x3e>;
			pinctrl-27 = <0x3f>;
			pinctrl-28 = <0x40>;
			pinctrl-29 = <0x41>;
			pinctrl-3 = <0x27>;
			pinctrl-30 = <0x42>;
			pinctrl-31 = <0x43>;
			pinctrl-32 = <0x44>;
			pinctrl-33 = <0x45>;
			pinctrl-34 = <0x46>;
			pinctrl-35 = <0x47>;
			pinctrl-36 = <0x48>;
			pinctrl-37 = <0x49>;
			pinctrl-38 = <0x4a>;
			pinctrl-39 = <0x4b>;
			pinctrl-4 = <0x28>;
			pinctrl-40 = <0x4c>;
			pinctrl-41 = <0x4d>;
			pinctrl-42 = <0x4e>;
			pinctrl-43 = <0x4f>;
			pinctrl-44 = <0x50>;
			pinctrl-45 = <0x51>;
			pinctrl-46 = <0x52>;
			pinctrl-47 = <0x53>;
			pinctrl-48 = <0x54>;
			pinctrl-49 = <0x55>;
			pinctrl-5 = <0x29>;
			pinctrl-50 = <0x56>;
			pinctrl-51 = <0x57>;
			pinctrl-52 = <0x58>;
			pinctrl-53 = <0x59>;
			pinctrl-6 = <0x2a>;
			pinctrl-7 = <0x2b>;
			pinctrl-8 = <0x2c>;
			pinctrl-9 = <0x2d>;
			pinctrl-names = "default\0cam0_rst0\0cam0_rst1\0cam1_rst0\0cam1_rst1\0cam2_rst0\0cam2_rst1\0cam3_rst0\0cam3_rst1\0cam4_rst0\0cam4_rst1\0cam0_ldo_vcamd_0\0cam0_ldo_vcamd_1\0cam0_ldo_vcama_0\0cam0_ldo_vcama_1\0cam1_ldo_vcamd_0\0cam1_ldo_vcamd_1\0cam1_ldo_vcama_0\0cam1_ldo_vcama_1\0cam2_ldo_vcama_0\0cam2_ldo_vcama_1\0cam3_ldo_vcama_0\0cam3_ldo_vcama_1\0cam4_ldo_vcama_0\0cam4_ldo_vcama_1\0cam0_mclk_off\0cam0_mclk_2mA\0cam0_mclk_4mA\0cam0_mclk_6mA\0cam0_mclk_8mA\0cam1_mclk_off\0cam1_mclk_2mA\0cam1_mclk_4mA\0cam1_mclk_6mA\0cam1_mclk_8mA\0cam2_mclk_off\0cam2_mclk_2mA\0cam2_mclk_4mA\0cam2_mclk_6mA\0cam2_mclk_8mA\0cam3_mclk_off\0cam3_mclk_2mA\0cam3_mclk_4mA\0cam3_mclk_6mA\0cam3_mclk_8mA\0cam4_mclk_off\0cam4_mclk_2mA\0cam4_mclk_4mA\0cam4_mclk_6mA\0cam4_mclk_8mA\0cam0_mipi_switch_sel_1\0cam0_mipi_switch_sel_0\0cam0_ldo_vcamd_sel_1\0cam0_ldo_vcamd_sel_0";
			status = "okay";
			vcammainaf-supply = <0xffffffff>;
		};
	};

	fragment@33 {
		target = <0xffffffff>;

		__overlay__ {

			camera_eeprom0@50 {
				compatible = "mediatek,camera_eeprom";
				phandle = <0x86>;
				reg = <0x50>;
				status = "okay";
			};
		};
	};

	fragment@34 {
		target = <0xffffffff>;

		__overlay__ {

			camera_eeprom1@51 {
				compatible = "mediatek,camera_eeprom";
				phandle = <0x87>;
				reg = <0x51>;
				status = "okay";
			};
		};
	};

	fragment@35 {
		target = <0xffffffff>;

		__overlay__ {

			camera_eeprom2@50 {
				compatible = "mediatek,camera_eeprom";
				phandle = <0x88>;
				reg = <0x50>;
				status = "okay";
			};
		};
	};

	fragment@36 {
		target = <0xffffffff>;

		__overlay__ {

			camera_eeprom3@52 {
				compatible = "mediatek,camera_eeprom";
				phandle = <0x89>;
				reg = <0x52>;
				status = "okay";
			};
		};
	};

	fragment@37 {
		target = <0xffffffff>;

		__overlay__ {

			camera_eeprom4@54 {
				compatible = "mediatek,camera_eeprom";
				phandle = <0x8a>;
				reg = <0x54>;
				status = "okay";
			};
		};
	};

	fragment@38 {
		target = <0xffffffff>;

		__overlay__ {

			adc_channel@ {
				compatible = "mediatek,adc_channel";
				mediatek,adc_fdd_rf_params_dynamic_custom_ch = <0x02>;
				mediatek,temperature0 = <0x00>;
				mediatek,temperature1 = <0x01>;
				status = "okay";
			};
		};
	};

	fragment@39 {
		target = <0xffffffff>;

		__overlay__ {
			io-channels = <0xffffffff 0x02>;
		};
	};

	fragment@4 {
		target = <0xffffffff>;

		__overlay__ {

			volume_down@0 {
				phandle = <0x02>;

				pins_cmd_dat {
					input-enable;
					pinmux = <0x5000>;
					slew-rate = <0x00>;
				};
			};

			volume_up@0 {
				phandle = <0x01>;

				pins_cmd_dat {
					input-enable;
					pinmux = <0x100>;
					slew-rate = <0x00>;
				};
			};
		};
	};

	fragment@40 {
		target = <0xffffffff>;

		__overlay__ {
			mediatek,clkbuf-config = <0x02 0x01 0x01 0x02 0x00 0x00 0x01>;
			mediatek,clkbuf-controls-for-desense = <0x00 0x04 0x00 0x04 0x00 0x00 0x00>;
			mediatek,clkbuf-output-impedance = <0x06 0x04 0x04 0x04 0x00 0x00 0x04>;
			mediatek,clkbuf-quantity = <0x07>;
			status = "okay";
		};
	};

	fragment@41 {
		target = <0xffffffff>;

		__overlay__ {
			#address-cells = <0x01>;
			#size-cells = <0x00>;
			clock-frequency = <0x61a80>;
			mediatek,use-open-drain;
		};
	};

	fragment@42 {
		target = <0xffffffff>;

		__overlay__ {
			#address-cells = <0x01>;
			#size-cells = <0x00>;
			clock-frequency = <0x61a80>;
			mediatek,use-open-drain;
		};
	};

	fragment@43 {
		target = <0xffffffff>;

		__overlay__ {
			#address-cells = <0x01>;
			#size-cells = <0x00>;
			clock-frequency = <0x61a80>;
			mediatek,use-open-drain;

			camera_main@1a {
				compatible = "mediatek,camera_main";
				phandle = <0x8c>;
				reg = <0x1a>;
				status = "okay";
			};

			camera_main_af@18 {
				compatible = "mediatek,camera_main_af";
				phandle = <0x8d>;
				reg = <0x18>;
				status = "okay";
			};

			camera_main_three@1b {
				compatible = "mediatek,camera_main_three";
				phandle = <0x8b>;
				reg = <0x1b>;
				status = "okay";
			};
		};
	};

	fragment@44 {
		target = <0xffffffff>;

		__overlay__ {
			#address-cells = <0x01>;
			#size-cells = <0x00>;
			clock-frequency = <0x61a80>;
			mediatek,use-open-drain;

			nfc@08 {
				compatible = "mediatek,nfc";
				phandle = <0x8e>;
				reg = <0x08>;
				status = "okay";
			};
		};
	};

	fragment@45 {
		target = <0xffffffff>;

		__overlay__ {
			#address-cells = <0x01>;
			#size-cells = <0x00>;
			clock-frequency = <0x61a80>;
			mediatek,use-open-drain;

			camera_sub@1a {
				compatible = "mediatek,camera_sub";
				phandle = <0x8f>;
				reg = <0x1a>;
				status = "okay";
			};

			camera_sub_two@1c {
				compatible = "mediatek,camera_sub_two";
				phandle = <0x90>;
				reg = <0x1c>;
				status = "okay";
			};
		};
	};

	fragment@46 {
		target = <0xffffffff>;

		__overlay__ {
			#address-cells = <0x01>;
			#size-cells = <0x00>;
			clock-frequency = <0x33e140>;
			mediatek,use-push-pull;

			subpmic@34 {
				compatible = "mediatek,subpmic";
				phandle = <0x91>;
				reg = <0x34>;
				status = "okay";
			};

			subpmic_ldo@64 {
				compatible = "mediatek,subpmic_ldo";
				phandle = <0x94>;
				reg = <0x64>;
				status = "okay";
			};

			subpmic_pmic@1a {
				compatible = "mediatek,subpmic_pmic";
				phandle = <0x93>;
				reg = <0x1a>;
				status = "okay";
			};

			usb_type_c@4e {
				compatible = "mediatek,usb_type_c";
				phandle = <0x92>;
				reg = <0x4e>;
				status = "okay";
			};
		};
	};

	fragment@47 {
		target = <0xffffffff>;

		__overlay__ {
			#address-cells = <0x01>;
			#size-cells = <0x00>;
			clock-frequency = <0x61a80>;
			mediatek,use-open-drain;

			i2c_lcd_bias@3e {
				compatible = "mediatek,i2c_lcd_bias";
				phandle = <0x95>;
				reg = <0x3e>;
				status = "okay";
			};
		};
	};

	fragment@48 {
		target = <0xffffffff>;

		__overlay__ {
			#address-cells = <0x01>;
			#size-cells = <0x00>;
			clock-frequency = <0x186a0>;
			mediatek,use-open-drain;
		};
	};

	fragment@49 {
		target = <0xffffffff>;

		__overlay__ {
			#address-cells = <0x01>;
			#size-cells = <0x00>;
			clock-frequency = <0x61a80>;
			mediatek,use-open-drain;

			camera_main_two@10 {
				compatible = "mediatek,camera_main_two";
				phandle = <0x96>;
				reg = <0x10>;
				status = "okay";
			};
		};
	};

	fragment@5 {
		target = <0xffffffff>;

		__overlay__ {
			#address-cells = <0x01>;
			#size-cells = <0x00>;

			aw87339@58 {
				compatible = "awinic,aw87339_pa_spk";
				reg = <0x58>;
				reset-gpio = <0xffffffff 0x8b 0x00>;
				status = "okay";
			};
		};
	};

	fragment@50 {
		target = <0xffffffff>;

		__overlay__ {
			#address-cells = <0x01>;
			#size-cells = <0x00>;
			clock-frequency = <0x61a80>;
			mediatek,use-open-drain;
		};
	};

	fragment@51 {
		target = <0xffffffff>;

		__overlay__ {
			GPIO_FDD_BAND_SUPPORT_DETECT_1ST_PIN = <0xffffffff 0xa6 0x00>;
			GPIO_FDD_BAND_SUPPORT_DETECT_2ND_PIN = <0xffffffff 0xa7 0x00>;
			GPIO_FDD_BAND_SUPPORT_DETECT_3RD_PIN = <0xffffffff 0xa8 0x00>;
			GPIO_FDD_BAND_SUPPORT_DETECT_4TH_PIN = <0xffffffff 0xa9 0x00>;
			GPIO_RF_PWREN_RST_PIN = <0xffffffff 0xab 0x00>;
			GPIO_SIM1_HOT_PLUG = <0xffffffff 0x4d 0x00>;
			GPIO_SIM1_SCLK = <0xffffffff 0x7c 0x00>;
			GPIO_SIM1_SIO = <0xffffffff 0x7a 0x00>;
			GPIO_SIM1_SRST = <0xffffffff 0x7b 0x00>;
			GPIO_SIM2_SCLK = <0xffffffff 0x77 0x00>;
			GPIO_SIM2_SIO = <0xffffffff 0x79 0x00>;
			GPIO_SIM2_SRST = <0xffffffff 0x78 0x00>;
		};
	};

	fragment@52 {
		target = <0xffffffff>;

		__overlay__ {
			gpio_init_default = <0x00 0x00 0x00 0x00 0x01 0x00 0x01 0x01 0x00 0x00 0x00 0x01 0x01 0x01 0x02 0x00 0x00 0x00 0x01 0x01 0x01 0x03 0x00 0x00 0x00 0x01 0x00 0x01 0x04 0x00 0x00 0x00 0x01 0x01 0x01 0x05 0x00 0x00 0x00 0x01 0x00 0x01 0x06 0x00 0x01 0x00 0x01 0x00 0x00 0x07 0x00 0x01 0x00 0x01 0x00 0x01 0x08 0x00 0x01 0x00 0x01 0x00 0x01 0x09 0x00 0x00 0x00 0x01 0x01 0x01 0x0a 0x00 0x00 0x00 0x01 0x01 0x01 0x0b 0x00 0x01 0x00 0x01 0x01 0x01 0x0c 0x02 0x00 0x00 0x01 0x00 0x01 0x0d 0x02 0x01 0x00 0x01 0x00 0x01 0x0e 0x00 0x00 0x00 0x01 0x01 0x01 0x0f 0x00 0x00 0x00 0x01 0x01 0x01 0x10 0x07 0x00 0x00 0x01 0x00 0x01 0x11 0x07 0x00 0x00 0x01 0x00 0x01 0x12 0x07 0x00 0x00 0x01 0x00 0x01 0x13 0x07 0x00 0x00 0x01 0x00 0x01 0x14 0x01 0x01 0x00 0x00 0x00 0x00 0x15 0x01 0x01 0x00 0x00 0x00 0x00 0x16 0x01 0x01 0x00 0x01 0x00 0x00 0x17 0x01 0x00 0x00 0x01 0x01 0x00 0x18 0x02 0x00 0x00 0x00 0x00 0x01 0x19 0x02 0x00 0x00 0x00 0x00 0x01 0x1a 0x02 0x00 0x00 0x00 0x00 0x01 0x1b 0x02 0x00 0x00 0x01 0x00 0x01 0x1c 0x01 0x00 0x00 0x00 0x00 0x00 0x1d 0x00 0x01 0x00 0x01 0x00 0x00 0x1e 0x01 0x00 0x00 0x00 0x00 0x00 0x1f 0x01 0x00 0x00 0x01 0x00 0x00 0x20 0x00 0x01 0x00 0x01 0x00 0x01 0x21 0x01 0x00 0x00 0x00 0x00 0x01 0x22 0x00 0x01 0x00 0x01 0x00 0x00 0x23 0x01 0x00 0x00 0x01 0x00 0x01 0x24 0x01 0x00 0x00 0x00 0x00 0x01 0x25 0x00 0x00 0x00 0x01 0x00 0x01 0x26 0x00 0x01 0x00 0x00 0x00 0x00 0x27 0x00 0x01 0x00 0x01 0x00 0x01 0x28 0x00 0x01 0x00 0x01 0x00 0x01 0x29 0x00 0x00 0x00 0x01 0x01 0x01 0x2a 0x07 0x00 0x00 0x01 0x00 0x01 0x2b 0x00 0x01 0x01 0x01 0x00 0x01 0x2c 0x07 0x00 0x00 0x01 0x00 0x01 0x2d 0x07 0x00 0x00 0x00 0x00 0x01 0x2e 0x07 0x00 0x00 0x01 0x00 0x01 0x2f 0x07 0x00 0x00 0x01 0x00 0x01 0x30 0x07 0x00 0x00 0x01 0x00 0x01 0x31 0x00 0x01 0x00 0x00 0x00 0x00 0x32 0x00 0x01 0x00 0x00 0x00 0x00 0x33 0x00 0x01 0x00 0x00 0x00 0x00 0x34 0x01 0x01 0x00 0x00 0x00 0x00 0x35 0x00 0x01 0x00 0x00 0x00 0x01 0x36 0x00 0x01 0x00 0x01 0x00 0x00 0x37 0x00 0x01 0x00 0x00 0x00 0x00 0x38 0x00 0x01 0x00 0x01 0x00 0x00 0x39 0x00 0x01 0x00 0x00 0x00 0x00 0x3a 0x00 0x01 0x00 0x00 0x00 0x00 0x3b 0x00 0x01 0x00 0x00 0x00 0x00 0x3c 0x00 0x01 0x00 0x00 0x00 0x00 0x3d 0x01 0x00 0x00 0x01 0x01 0x00 0x3e 0x01 0x00 0x00 0x00 0x00 0x00 0x3f 0x00 0x01 0x00 0x01 0x00 0x00 0x40 0x00 0x01 0x00 0x01 0x00 0x00 0x4c 0x00 0x00 0x00 0x01 0x01 0x01 0x4d 0x01 0x00 0x00 0x01 0x01 0x01 0x4e 0x00 0x00 0x00 0x01 0x00 0x01 0x4f 0x01 0x00 0x00 0x01 0x01 0x01 0x50 0x00 0x00 0x00 0x00 0x00 0x00 0x51 0x03 0x00 0x00 0x01 0x00 0x01 0x52 0x00 0x01 0x00 0x01 0x00 0x01 0x53 0x01 0x00 0x00 0x00 0x00 0x01 0x54 0x01 0x00 0x00 0x01 0x00 0x01 0x55 0x01 0x00 0x00 0x00 0x00 0x01 0x56 0x00 0x01 0x00 0x01 0x00 0x00 0x57 0x02 0x00 0x00 0x01 0x00 0x01 0x58 0x00 0x00 0x00 0x01 0x00 0x01 0x59 0x00 0x00 0x00 0x01 0x00 0x01 0x5a 0x01 0x00 0x00 0x00 0x00 0x01 0x5b 0x00 0x01 0x00 0x00 0x00 0x00 0x5c 0x00 0x01 0x00 0x01 0x00 0x01 0x5d 0x00 0x00 0x00 0x01 0x01 0x01 0x5e 0x00 0x01 0x00 0x01 0x00 0x01 0x5f 0x01 0x00 0x00 0x01 0x00 0x01 0x60 0x01 0x00 0x00 0x01 0x00 0x01 0x61 0x01 0x00 0x00 0x01 0x01 0x01 0x62 0x01 0x00 0x00 0x01 0x01 0x01 0x63 0x02 0x00 0x00 0x01 0x01 0x01 0x64 0x02 0x00 0x00 0x01 0x01 0x01 0x65 0x01 0x00 0x00 0x01 0x01 0x01 0x66 0x01 0x00 0x00 0x01 0x01 0x01 0x67 0x01 0x00 0x00 0x01 0x01 0x01 0x68 0x01 0x00 0x00 0x01 0x01 0x01 0x69 0x01 0x00 0x00 0x01 0x01 0x01 0x6a 0x01 0x00 0x00 0x01 0x01 0x01 0x6b 0x01 0x00 0x00 0x01 0x01 0x01 0x6c 0x01 0x00 0x00 0x01 0x01 0x01 0x6d 0x01 0x00 0x00 0x01 0x01 0x01 0x6e 0x01 0x00 0x00 0x01 0x01 0x01 0x6f 0x01 0x00 0x00 0x01 0x01 0x01 0x70 0x01 0x00 0x00 0x01 0x01 0x01 0x71 0x01 0x00 0x00 0x01 0x01 0x01 0x72 0x01 0x00 0x00 0x01 0x01 0x01 0x73 0x01 0x00 0x00 0x00 0x00 0x01 0x74 0x01 0x00 0x00 0x00 0x00 0x01 0x75 0x01 0x00 0x00 0x00 0x00 0x01 0x76 0x01 0x00 0x00 0x00 0x00 0x01 0x77 0x01 0x00 0x00 0x00 0x00 0x01 0x78 0x01 0x00 0x00 0x00 0x00 0x01 0x79 0x01 0x00 0x00 0x01 0x01 0x01 0x7a 0x01 0x00 0x00 0x01 0x01 0x01 0x7b 0x01 0x00 0x00 0x00 0x00 0x01 0x7c 0x01 0x00 0x00 0x00 0x00 0x01 0x7d 0x01 0x00 0x00 0x00 0x00 0x01 0x7e 0x01 0x00 0x00 0x01 0x01 0x01 0x7f 0x01 0x00 0x00 0x01 0x01 0x01 0x80 0x00 0x01 0x00 0x01 0x00 0x01 0x81 0x01 0x00 0x00 0x01 0x01 0x01 0x82 0x01 0x00 0x00 0x01 0x01 0x01 0x83 0x00 0x01 0x00 0x01 0x00 0x01 0x84 0x00 0x01 0x00 0x01 0x00 0x01 0x85 0x00 0x01 0x00 0x01 0x00 0x01 0x86 0x00 0x01 0x00 0x01 0x00 0x01 0x87 0x00 0x01 0x00 0x01 0x00 0x01 0x88 0x00 0x01 0x01 0x01 0x00 0x01 0x89 0x00 0x01 0x00 0x01 0x00 0x01 0x8a 0x00 0x01 0x00 0x01 0x00 0x01 0x8b 0x00 0x01 0x00 0x01 0x00 0x01 0x8c 0x00 0x01 0x00 0x01 0x00 0x01 0x8d 0x02 0x00 0x00 0x01 0x00 0x01 0x8e 0x02 0x00 0x00 0x01 0x00 0x01 0x8f 0x01 0x00 0x00 0x00 0x00 0x01 0x90 0x01 0x00 0x00 0x00 0x00 0x01 0x91 0x01 0x00 0x00 0x00 0x00 0x01 0x92 0x01 0x00 0x00 0x00 0x00 0x01 0x93 0x01 0x00 0x00 0x00 0x00 0x01 0x94 0x01 0x00 0x00 0x00 0x00 0x01 0x95 0x01 0x00 0x00 0x01 0x00 0x01 0x96 0x01 0x00 0x00 0x01 0x00 0x01 0x97 0x01 0x00 0x00 0x01 0x00 0x01 0x98 0x01 0x00 0x00 0x00 0x00 0x01 0x99 0x01 0x00 0x00 0x00 0x00 0x01 0x9a 0x01 0x00 0x00 0x00 0x00 0x01 0x9b 0x01 0x00 0x00 0x00 0x00 0x01 0x9c 0x01 0x00 0x00 0x00 0x00 0x01 0x9d 0x01 0x00 0x00 0x00 0x00 0x01 0x9e 0x01 0x00 0x00 0x00 0x00 0x01 0x9f 0x01 0x00 0x00 0x01 0x00 0x01 0xa0 0x01 0x00 0x00 0x01 0x00 0x01 0xa1 0x01 0x00 0x00 0x01 0x00 0x01 0xa2 0x01 0x00 0x00 0x00 0x00 0x00 0xa3 0x01 0x00 0x00 0x01 0x00 0x00 0xa4 0x01 0x00 0x00 0x01 0x00 0x01 0xa5 0x01 0x00 0x00 0x01 0x00 0x01 0xa6 0x00 0x00 0x00 0x01 0x00 0x00 0xa7 0x00 0x00 0x00 0x01 0x00 0x00 0xa8 0x00 0x00 0x00 0x01 0x00 0x00 0xa9 0x00 0x00 0x00 0x01 0x00 0x00 0xaa 0x01 0x00 0x00 0x00 0x00 0x01 0xab 0x00 0x01 0x01 0x00 0x00 0x01 0xac 0x01 0x00 0x00 0x00 0x00 0x01 0xad 0x01 0x00 0x00 0x00 0x00 0x01 0xae 0x01 0x00 0x00 0x00 0x00 0x01 0xaf 0x00 0x00 0x00 0x01 0x01 0x00 0xb0 0x01 0x00 0x00 0x00 0x00 0x01 0xb1 0x01 0x00 0x00 0x00 0x00 0x01 0xb2 0x01 0x00 0x00 0x00 0x00 0x01 0xb3 0x01 0x00 0x00 0x00 0x00 0x01 0xb4 0x01 0x00 0x00 0x00 0x00 0x01 0xb5 0x01 0x00 0x00 0x00 0x00 0x01 0xb6 0x01 0x00 0x00 0x00 0x00 0x01 0xb7 0x01 0x00 0x00 0x00 0x00 0x01 0xb8 0x01 0x00 0x00 0x00 0x00 0x01 0xb9 0x01 0x00 0x00 0x00 0x00 0x01 0xba 0x01 0x00 0x00 0x00 0x00 0x01 0xbb 0x01 0x00 0x00 0x00 0x00 0x01 0xbc 0x01 0x00 0x00 0x00 0x00 0x00 0xbd 0x01 0x00 0x00 0x01 0x00 0x00 0xbe 0x01 0x00 0x00 0x00 0x00 0x00 0xbf 0x01 0x00 0x00 0x01 0x00 0x00 0xc0 0x00 0x00 0x00 0x01 0x00 0x01 0xc1 0x00 0x00 0x00 0x01 0x00 0x01 0xc2 0x00 0x00 0x00 0x01 0x00 0x01 0xc3 0x00 0x00 0x00 0x01 0x00 0x01 0xc4 0x00 0x00 0x00 0x01 0x00 0x01 0xc5 0x00 0x00 0x00 0x01 0x00 0x01 0xc6 0x00 0x00 0x00 0x01 0x00 0x01 0xc7 0x00 0x00 0x00 0x01 0x00 0x01 0xc8 0x00 0x00 0x00 0x01 0x00 0x01 0xc9 0x00 0x00 0x00 0x01 0x00 0x01 0xca 0x00 0x00 0x00 0x01 0x00 0x01 0xcb 0x00 0x00 0x00 0x01 0x00 0x00 0xcc 0x00 0x00 0x00 0x01 0x00 0x00 0xcd 0x00 0x00 0x00 0x01 0x00 0x00 0xce 0x00 0x00 0x00 0x01 0x00 0x00 0xcf 0x00 0x00 0x00 0x01 0x00 0x00 0xd0 0x00 0x00 0x00 0x01 0x00 0x00 0xd1 0x00 0x00 0x00 0x01 0x00 0x00 0xd2 0x00 0x00 0x00 0x01 0x00 0x00 0xd3 0x00 0x00 0x00 0x01 0x00 0x00>;
		};
	};

	fragment@53 {
		target = <0xffffffff>;

		__overlay__ {
			deb-gpios = <0xffffffff 0x01 0x00>;
			debounce = <0x7d000>;
			interrupt-parent = <0xffffffff>;
			interrupts = <0x01 0x08>;
			status = "okay";
		};
	};

	fragment@54 {
		target = <0xffffffff>;

		__overlay__ {
			interrupt-parent = <0xffffffff>;
			interrupts = <0x05 0x04>;
			status = "okay";
		};
	};

	fragment@55 {
		target = <0xffffffff>;

		__overlay__ {
			interrupt-parent = <0xffffffff>;
			interrupts = <0x09 0x02>;
			status = "okay";
		};
	};

	fragment@56 {
		target = <0xffffffff>;

		__overlay__ {
			interrupt-parent = <0xffffffff>;
			interrupts = <0x0a 0x02>;
			status = "okay";
		};
	};

	fragment@57 {
		target = <0xffffffff>;

		__overlay__ {
			deb-gpios = <0xffffffff 0x4c 0x00>;
			interrupt-parent = <0xffffffff>;
			interrupts = <0x4c 0x04>;
			status = "okay";
		};
	};

	fragment@58 {
		target = <0xffffffff>;

		__overlay__ {
			interrupt-parent = <0xffffffff>;
			interrupts = <0x54 0x01>;
			status = "okay";
		};
	};

	fragment@59 {
		target = <0xffffffff>;

		__overlay__ {
			compatible = "mediatek,md1_sim1_hot_plug_eint-eint";
			debounce = <0x00 0xc350>;
			dedicated = <0x00 0x00>;
			interrupts = <0x00 0x08>;
			sockettype = <0x00 0x00>;
			src_pin = <0x00 0x01>;
			status = "okay";
		};
	};

	fragment@6 {
		target = <0xffffffff>;

		__overlay__ {
			compatible = "mediatek,snd_audio_dsp";
			mtk_dsp_a2dp = <0x00 0xffffffff 0xffffffff 0xffffffff 0x40000>;
			mtk_dsp_call_final = <0x01 0x04 0x10 0x14 0x18000>;
			mtk_dsp_capture1 = <0x01 0xffffffff 0x0d 0x13 0x20000>;
			mtk_dsp_dataprovider = <0x00 0xffffffff 0x0f 0xffffffff 0x30000>;
			mtk_dsp_deep = <0x05 0x03 0xffffffff 0xffffffff 0x30000>;
			mtk_dsp_fast = <0x05 0x02 0xffffffff 0xffffffff 0x5000>;
			mtk_dsp_ktv = <0x01 0x08 0x12 0xffffffff 0x10000>;
			mtk_dsp_music = <0x01 0xffffffff 0xffffffff 0xffffffff 0x00>;
			mtk_dsp_offload = <0x00 0x06 0xffffffff 0xffffffff 0x400000>;
			mtk_dsp_playback = <0x01 0x04 0x10 0x14 0x30000>;
			mtk_dsp_primary = <0x1f 0x00 0xffffffff 0xffffffff 0x30000>;
			mtk_dsp_ver = <0x01>;
			mtk_dsp_voip = <0x1f 0x01 0xffffffff 0xffffffff 0x30000>;
			swdsp_smartpa_process_enable = <0x01 0x40000>;
		};
	};

	fragment@60 {
		target = <0xffffffff>;

		__overlay__ {
			regulator-default-on = <0x00>;
			regulator-name = "vcamio";
			status = "okay";
		};
	};

	fragment@61 {
		target = <0xffffffff>;

		__overlay__ {
			regulator-default-on = <0x01>;
			regulator-name = "vtp";
			status = "okay";
		};
	};

	fragment@62 {
		target = <0xffffffff>;

		__overlay__ {
			status = "okay";
			vcamio-supply = <0xffffffff>;
		};
	};

	fragment@63 {
		target = <0xffffffff>;

		__overlay__ {
			status = "okay";
			vtouch-supply = <0xffffffff>;
		};
	};

	fragment@64 {
		target = <0xffffffff>;

		__overlay__ {
			mediatek,kpd-hw-dl-key0 = <0x11>;
			mediatek,kpd-hw-dl-key1 = <0x00>;
			mediatek,kpd-hw-dl-key2 = <0x08>;
			mediatek,kpd-hw-factory-key = <0x00>;
			mediatek,kpd-hw-init-map = <0x72 0x00 0x00 0x00 0x00 0x00 0x00 0x00 0x00 0x00 0x00 0x00 0x00 0x00 0x00 0x00 0x00 0x00 0x00 0x00 0x00 0x00 0x00 0x00 0x00 0x00 0x00 0x00 0x00 0x00 0x00 0x00 0x00 0x00 0x00 0x00 0x00 0x00 0x00 0x00 0x00 0x00 0x00 0x00 0x00 0x00 0x00 0x00 0x00 0x00 0x00 0x00 0x00 0x00 0x00 0x00 0x00 0x00 0x00 0x00 0x00 0x00 0x00 0x00 0x00 0x00 0x00 0x00 0x00 0x00 0x00 0x00>;
			mediatek,kpd-hw-map-num = <0x48>;
			mediatek,kpd-hw-pwrkey = <0x08>;
			mediatek,kpd-hw-recovery-key = <0x11>;
			mediatek,kpd-hw-rstkey = <0x11>;
			mediatek,kpd-key-debounce = <0x400>;
			mediatek,kpd-pwkey-gpio-din = <0x00>;
			mediatek,kpd-pwrkey-eint-gpio = <0x00>;
			mediatek,kpd-sw-pwrkey = <0x74>;
			mediatek,kpd-sw-rstkey = <0x73>;
			mediatek,kpd-use-extend-type = <0x00>;
			status = "okay";
		};
	};

	fragment@65 {
		target = <0xffffffff>;

		__overlay__ {

			lcd_bias_enn0_gpio {
				phandle = <0x62>;

				pins_cmd_dat {
					output-low;
					pinmux = <0x8a00>;
					slew-rate = <0x01>;
				};
			};

			lcd_bias_enn1_gpio {
				phandle = <0x61>;

				pins_cmd_dat {
					output-high;
					pinmux = <0x8a00>;
					slew-rate = <0x01>;
				};
			};

			lcd_bias_enp0_gpio {
				phandle = <0x60>;

				pins_cmd_dat {
					output-low;
					pinmux = <0x8900>;
					slew-rate = <0x01>;
				};
			};

			lcd_bias_enp1_gpio {
				phandle = <0x5f>;

				pins_cmd_dat {
					output-high;
					pinmux = <0x8900>;
					slew-rate = <0x01>;
				};
			};

			lcm_dsi_te {
				phandle = <0x5c>;

				pins_cmd_dat {
					pinmux = <0x5401>;
				};
			};

			lcm_rst_out0_gpio {
				phandle = <0x5b>;

				pins_cmd_dat {
					output-low;
					pinmux = <0x5600>;
					slew-rate = <0x01>;
				};
			};

			lcm_rst_out1_gpio {
				phandle = <0x5a>;

				pins_cmd_dat {
					output-high;
					pinmux = <0x5600>;
					slew-rate = <0x01>;
				};
			};
		};
	};

	fragment@66 {
		target = <0xffffffff>;

		__overlay__ {
			pinctrl-0 = <0x5a>;
			pinctrl-1 = <0x5b>;
			pinctrl-2 = <0x5c>;
			pinctrl-names = "lcm_rst_out1_gpio\0lcm_rst_out0_gpio\0mode_te_te";
			status = "okay";
		};
	};

	fragment@67 {
		target = <0xffffffff>;

		__overlay__ {
			#address-cells = <0x01>;
			#size-cells = <0x00>;
			status = "okay";
			switch_fps = <0x00>;

			panel1@0 {
				bias-gpios = <0xffffffff 0x89 0x00 0xffffffff 0x8a 0x00>;
				compatible = "hx83112f,dphy,vdo";
				pinctrl-names = "default";
				pm-enable-gpios = <0xffffffff 0x29 0x00>;
				reg = <0x00>;
				reset-gpios = <0xffffffff 0x56 0x00>;

				port {

					endpoint {
						phandle = <0x5e>;
						remote-endpoint = <0x5d>;
					};
				};
			};

			panel2@0 {
				bias-gpios = <0xffffffff 0x89 0x00 0xffffffff 0x8a 0x00>;
				compatible = "oppo20611,nt36672c,tm,fhdp,dsi,vdo,dphy";
				lcd-1p8-gpios = <0xffffffff 0x88 0x00>;
				pinctrl-names = "default";
				pm-enable-gpios = <0xffffffff 0x29 0x00>;
				reg = <0x01>;
				reset-gpios = <0xffffffff 0x56 0x00>;

				port {

					endpoint {
						phandle = <0x97>;
						remote-endpoint = <0x5d>;
					};
				};
			};

			panel3@0 {
				bias-gpios = <0xffffffff 0x89 0x00 0xffffffff 0x8a 0x00>;
				compatible = "jdi,nt36672c,dphy,vdo,120";
				lcd-1p8-gpios = <0xffffffff 0x88 0x00>;
				pinctrl-names = "default";
				pm-enable-gpios = <0xffffffff 0x29 0x00>;
				reg = <0x02>;
				reset-gpios = <0xffffffff 0x56 0x00>;

				port {

					endpoint {
						phandle = <0x98>;
						remote-endpoint = <0x5d>;
					};
				};
			};

			panel4@0 {
				compatible = "tianma,hx83112f,dphy,vdo";
				ldo3-supply = <0xffffffff>;
				ldo5-supply = <0xffffffff>;
				pinctrl-names = "default";
				pm-enable-gpios = <0xffffffff 0x54 0x00>;
				reg = <0x03>;
				reset-gpios = <0xffffffff 0x56 0x00>;

				port {

					endpoint {
						phandle = <0x99>;
						remote-endpoint = <0x5d>;
					};
				};
			};

			ports {

				port {

					endpoint {
						phandle = <0x5d>;
						remote-endpoint = <0x5e>;
					};
				};
			};
		};
	};

	fragment@68 {
		target = <0xffffffff>;

		__overlay__ {
			pinctrl-0 = <0x5f>;
			pinctrl-1 = <0x60>;
			pinctrl-2 = <0x61>;
			pinctrl-3 = <0x62>;
			pinctrl-4 = <0x5a>;
			pinctrl-5 = <0x5b>;
			pinctrl-6 = <0x5c>;
			pinctrl-names = "lcd_bias_enp1_gpio\0lcd_bias_enp0_gpio\0lcd_bias_enn1_gpio\0lcd_bias_enn0_gpio\0lcm_rst_out1_gpio\0lcm_rst_out0_gpio\0mode_te_te";
			status = "okay";
		};
	};

	fragment@69 {
		target = <0xffffffff>;

		__overlay__ {
			accdet-mic-mode = <0x02>;
			accdet-mic-vol = <0x08>;
			accdet-plugout-debounce = <0x01>;
			eint_detect_mode = <0x05>;
			eint_use_ext_res = <0x00>;
			headset-four-key-threshold = <0x00 0x3a 0x79 0xc0 0x190>;
			headset-mode-setting = <0x500 0x500 0x01 0x1f0 0x2000 0x800 0x2000 0x44 0x00 0x07 0x05 0x09 0x09 0x0d 0x0e>;
			headset-three-key-threshold = <0x00 0x52 0xaa 0x132>;
			headset-three-key-threshold-CDD = <0x00 0x79 0xc0 0x258>;
			moisture-external-r = <0x1e8480>;
			moisture-internal-r = <0xb798>;
			moisture-water-r = <0x2710>;
			moisture_comp_vref2 = <0x02>;
			moisture_comp_vth = <0x02>;
			moisture_detect_enable = <0x01>;
			moisture_detect_mode = <0x05>;
			moisture_use_ext_res = <0x00>;
			status = "okay";
		};
	};

	fragment@7 {
		target = <0xffffffff>;

		__overlay__ {
			disable_lpsd = <0x01>;
			mt6360,intr_gpio = <0xffffffff 0x0a 0x00>;
			mt6360,intr_gpio_num = <0x0a>;
		};
	};

	fragment@70 {
		target = <0xffffffff>;

		__overlay__ {
			pinctrl-0 = <0x63>;
			pinctrl-1 = <0x64>;
			pinctrl-names = "irtx_gpio_led_default\0irtx_gpio_led_set";
			status = "okay";
		};
	};

	fragment@71 {
		target = <0xffffffff>;

		__overlay__ {

			irtx_gpio_led_def@gpio57 {
				phandle = <0x63>;

				pins_cmd_dat {
					bias-disable;
					input-schmitt-enable = <0x00>;
					output-low;
					pinmux = <0x3900>;
					slew-rate = <0x01>;
				};
			};

			irtx_gpio_led_set@gpio57 {
				phandle = <0x64>;

				pins_cmd_dat {
					output-high;
					pinmux = <0x3907>;
					slew-rate = <0x01>;
				};
			};
		};
	};

	fragment@72 {
		target = <0xffffffff>;

		__overlay__ {
			oppo,fp_gpio = <0x29>;
			oppo,fp_gpio_id = <0xffffffff 0x29 0x00>;
			pinctrl-0 = <0x65>;
			pinctrl-names = "default";

			fpc_id {
				chip-name = "F_1541";
				eng-menu = "-1,-1";
				oppo,fp-id = <0x00>;
				vendor-chip = <0x11>;
			};

			goodix_optical {
				chip-name = "G_3626";
				eng-menu = "-1,-1";
				oppo,fp-id = <0x01>;
				vendor-chip = <0x10>;
			};
		};
	};

	fragment@73 {
		target = <0xffffffff>;

		__overlay__ {

			gpio_id0_default {
				phandle = <0x65>;

				pins_cmd_dat {
					bias-pull-up = <0x00>;
					input-enable;
					pinmux = <0x2900>;
					slew-rate = <0x00>;
				};
			};
		};
	};

	fragment@74 {
		target = <0xffffffff>;

		__overlay__ {
			fpc,gpio_cs = <0xffffffff 0x1d 0x00>;
			fpc,irq-gpio = <0xffffffff 0x07 0x00>;
			fpc,reset-gpio = <0xffffffff 0x06 0x00>;
			fpc,vdd-en = <0xffffffff 0x83 0x00>;
			pinctrl-0 = <0x66 0x67 0x68>;
			pinctrl-1 = <0x69>;
			pinctrl-names = "default\0fpc_cs_func";
			pw_en_gpio = <0xffffffff 0x83 0x00>;
			status = "okay";

			power_source_1 {
				delay-time = <0x00>;
				power-mode = <0x02>;
				power-name = "pw_en_gpio";
				poweron-level = <0x00>;
			};
		};
	};

	fragment@75 {
		target = <0xffffffff>;

		__overlay__ {

			fpc_irq_default {
				phandle = <0x67>;

				pins_cmd_dat {
					bias-pull-up = <0x00>;
					pinmux = <0x700>;
					slew-rate = <0x00>;
				};
			};

			fpc_pwr_default {
				phandle = <0x68>;

				pins_cmd_dat {
					bias-disable;
					output-low;
					pinmux = <0x8300>;
					slew-rate = <0x01>;
				};
			};

			fpc_reset_default {
				phandle = <0x66>;

				pins_cmd_dat {
					output-low;
					pinmux = <0x600>;
					slew-rate = <0x01>;
				};
			};

			gpio_fpc_cs_func {
				phandle = <0x69>;

				pins_cmd_dat {
					drive-strength = <0x03>;
					pinmux = <0x1d01>;
				};
			};
		};
	};

	fragment@76 {
		target = <0xffffffff>;

		__overlay__ {
			goodix,gpio_cs = <0xffffffff 0x1d 0x00>;
			goodix,gpio_irq = <0xffffffff 0x07 0x00>;
			goodix,gpio_reset = <0xffffffff 0x06 0x00>;
			pinctrl-0 = <0x6a 0x6b>;
			pinctrl-1 = <0x6c 0x6d 0x6e 0x6f>;
			pinctrl-2 = <0x70>;
			pinctrl-names = "default\0gf_spi_drive_6mA\0gf_cs_func";
			status = "okay";
		};
	};

	fragment@77 {
		target = <0xffffffff>;

		__overlay__ {
			#address-cells = <0x01>;
			#size-cells = <0x00>;
			status = "okay";

			fingerprint@0 {
				compatible = "oppo,oppo_fp";
				dvdd-config = <0x2dc6c0 0x2dc6c0 0x249f0>;
				dvdd-supply = <0xffffffff>;
				phandle = <0x9a>;
				power-num = <0x02>;
				reg = <0x00>;
				spi-id = <0x05>;
				spi-irq = <0x27>;
				spi-max-frequency = <0x7a1200>;
				spi-reg = <0xa822f8>;
				status = "okay";

				power_source_1 {
					delay-time = <0x00>;
					power-config = "dvdd-config";
					power-mode = <0x01>;
					power-name = "dvdd";
				};
			};
		};
	};

	fragment@78 {
		target = <0xffffffff>;

		__overlay__ {

			gpio_goodix_clk_6mA {
				phandle = <0x6c>;

				pins_cmd_dat {
					drive-strength = <0x02>;
					pinmux = <0x1c01>;
				};
			};

			gpio_goodix_cs_6mA {
				phandle = <0x6f>;

				pins_cmd_dat {
					drive-strength = <0x02>;
					pinmux = <0x1d01>;
				};
			};

			gpio_goodix_cs_func {
				phandle = <0x70>;

				pins_cmd_dat {
					drive-strength = <0x02>;
					pinmux = <0x1d01>;
				};
			};

			gpio_goodix_irq_default {
				phandle = <0x6a>;

				pins_cmd_dat {
					bias-pull-down;
					pinmux = <0x700>;
					slew-rate = <0x00>;
				};
			};

			gpio_goodix_miso_6mA {
				phandle = <0x6e>;

				pins_cmd_dat {
					drive-strength = <0x03>;
					pinmux = <0x1f01>;
				};
			};

			gpio_goodix_mosi_6mA {
				phandle = <0x6d>;

				pins_cmd_dat {
					drive-strength = <0x02>;
					pinmux = <0x1e01>;
				};
			};

			gpio_goodix_reset_default {
				phandle = <0x6b>;

				pins_cmd_dat {
					output-low;
					pinmux = <0x600>;
					slew-rate = <0x01>;
				};
			};
		};
	};

	fragment@79 {
		target = <0xffffffff>;

		__overlay__ {

			power_helper {
				compatible = "oplus,power-helper";
			};
		};
	};

	fragment@8 {
		target = <0xffffffff>;

		__overlay__ {
			pwr_off_seq = <0x4000002>;
		};
	};

	fragment@9 {
		target = <0xffffffff>;

		__overlay__ {
			mt6360pd,intr_gpio = <0xffffffff 0x09 0x00>;
			mt6360pd,intr_gpio_num = <0x09>;
		};
	};
};
